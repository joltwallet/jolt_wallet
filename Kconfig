## jolt_os/Kconfig
```kconfig
menu "JoltOS"
    menu "Touch Pads"
        config JOLT_TOUCH_LED_PIN
            int
            prompt "Pin for controlling Touch LEDs"
            default 26
            help
                Help Text Here

        config JOLT_TOUCH_LED_DEFAULT_DUTY
            int
            range 0 255
            default 100
            prompt "Default touch led brightness"
            help
                0 = 0%; 255 = 100%

        config JOLT_TOUCH_LED_INVERT
            bool
            prompt "Invert the PWM signal"
            default y
            help
                If the LED's are active-low, set this to yes. Otherwise, set as no.
    endmenu

    menu "I2C"
        config JOLT_I2C_MASTER_NUM
            int
            prompt "Which I2C port to use"
            default 1
            help
                Help Text Here

        config JOLT_I2C_PIN_SDA
            int
            prompt "SDA GPIO PIN"
            default 23
            help
                I2C SDA GPIO pin number.

        config JOLT_I2C_PIN_SCL
            int
            prompt "SCL GPIO PIN"
            default 22
            help
                I2C SCL GPIO pin number.

        config JOLT_I2C_MASTER_FREQ_HZ
            int
            prompt "Master I2C Clock Freq"
            default 1000000
            help
                Help Text Here

        config JOLT_I2C_TIMEOUT_MS
            int
            prompt "I2C Timeout in milliseconds"
            default 1000
            help
                Help Text Here

        config JOLT_I2C_ERROR_RESET
            bool
            prompt "Reset if unable to contact i2c device"
            default n
            help
                If yes, Jolt will reboot on failure to communicate with the 
                an i2c device (display, etc). If no, it will continue operating as usual.
    endmenu

    menu "Display"
        choice
            prompt "Select Display Type"
            config JOLT_DISPLAY_TYPE_SSD1306
                bool "SSD1306"
                help
                    Help text here
            config JOLT_DISPLAY_TYPE_SH1106
                bool "SH1106"
                help
                    Help text here
        endchoice

        config JOLT_DISPLAY_BRIGHTNESS
            int
            prompt "Default display brightness"
            default 5
            range 0 5
            help
                Brightness index indicating screen brightness level; 0 is dimmest, 6 is brightest

        config JOLT_DISPLAY_FLIP
            bool
            prompt "Rotate the display buffer 180 degrees"
            default y
            help
                Flip everything drawn to the display; used depending on how
                your screen is mounted in your hardware setup.

        config JOLT_DISPLAY_ADDRESS
            hex
            prompt "Display I2C Address"
            default 0x3C
            help
                I2C Display's Address prior to left shift.

        config JOLT_DISPLAY_PIN_RST
           int
           prompt "Display Reset GPIO"
           default 16
           help
              GPIO thats connected to the display's RST pin.
    endmenu

    menu "GUI"

        config JOLT_GUI_LOADINGBAR_ANIM_MS
            int
            prompt "Loading bar animation catchup time in ms"
            default 100
            help
                help text here

        config JOLT_GUI_STATUSBAR_UPDATE_PERIOD_MS
            int
            prompt "Number of milliseconds between statusbar updates"
            default 273
            help
                help text here

        config JOLT_HW_MONITOR_UPDATE_PERIOD_MS
            int
            prompt "Number of milliseconds between hardware measurements like battery voltage, wifi strength, etc."
            default 100
            help
                help text here.

    endmenu

    menu "Compression"

        config JOLT_COMPRESSION_OUTPUT_BUFFER
            int
            prompt "Output Decompression Buffer Size. Must be at least as big as dictionary"
            default 4096
            help
                Default zlib requires 32KB of decompression buffer. Reducing the dictionary window to 4KB reduces compression efficiency by a percent or two, but requires 8x less RAM.

        config JOLT_COMPRESSION_AUTO
            bool
            prompt "Automatically decompress .hs files"
            default y
            help
                Automatically decompress ".hs" files when received.
    endmenu

    menu "Vault"
        config JOLT_VAULT_DEFAULT_TIMEOUT_S
            int
            prompt "Default idle time in seconds before wiping vault from memory."
            default 300
            help
                help text here

        config JOLT_VAULT_TIMEOUT_TIMEOUT_MS
            int
            prompt "Maximum number of time in milliseconds for Private Node Watchdog to wait to obtain private node mutex."
            default 1000
            help
                help text here
    endmenu

    choice
        prompt "Select Mnemonic Storage Method"
        config JOLT_STORE_INTERNAL
            bool "Simple SPI Flash"
            help
               Requires no external components. Unsafe against replay attacks.
        config JOLT_STORE_ATAES132A
            bool "ATAES132A Secure EEPROM"
            help
                Use ATAES132A to store Mnemonic and pin attempts. Also uses
                device to stretch keys, making brute force attempts less
                feasible.
        config JOLT_STORE_ATECC608A
            bool "ATECC608A Secure Co-Processor"
            help
                [NOT READY] Use ATECC608A to store Mnemonic, pin attempts, and Jolt 
                authentication data. Also uses device to stretch keys, making 
                brute force attempts less feasible.
    endchoice

    menu "ATAES132A"
        depends on JOLT_STORE_ATAES132A
        config JOLT_AES132_STRETCH_ITER
            int
            prompt "Number of encrpytion iterations to slow down pin derivation"
            default 300
            help
                A single iteration typically takes 2.4mS on device, but 
                communication overhead and freeRTOS ticks makes this more
                around 7mS.
        config JOLT_AES132_LOCK
            bool
            prompt "Lock ATAES132A after configuring"
            default n
            help
                For secure use of Jolt, you must lock the ataes132a device.
                Locking is a permament action. It is useful to not lock while
                implementing and debugging new security features.
    endmenu

    menu "External Storage"
        config JOLT_EXT_STORAGE_EN
            bool
            prompt "Enable external storage"
            default n
            help
                See https://github.com/espressif/esp-idf/tree/master/examples/storage/sd_card

        config JOLT_EXT_STORAGE_DAT0_PIN
            depends on JOLT_EXT_STORAGE_EN
            int 
            range 0 39
            default 2
            help
                SD/eMMc DAT0 pin.
        config JOLT_EXT_STORAGE_DAT1_PIN
            depends on JOLT_EXT_STORAGE_EN
            int 
            range 0 39
            default 4
            help
                SD/eMMc DAT1 pin.
        config JOLT_EXT_STORAGE_DAT2_PIN
            depends on JOLT_EXT_STORAGE_EN
            int 
            range 0 39
            default 12
            help
                SD/eMMc DAT2 pin.
        config JOLT_EXT_STORAGE_DAT3_PIN
            depends on JOLT_EXT_STORAGE_EN
            int 
            range 0 39
            default 13
            help
                SD/eMMc DAT3 pin.
        config JOLT_EXT_STORAGE_CMD_PIN
            depends on JOLT_EXT_STORAGE_EN
            int 
            range 0 39
            default 15
            help
                SD/eMMc CMD pin.
        config JOLT_EXT_STORAGE_CLK_PIN
            depends on JOLT_EXT_STORAGE_EN
            int 
            range 0 39
            default 14
            help
                SD/eMMc CLK pin.
    endmenu

    menu "Console"

        config JOLT_CONSOLE_STARTUP_CLEAR
            bool
            prompt "Clear serial monitor upon startup/console launch."
            default y
            help
                Clears the serial monitor view.

        config JOLT_CONSOLE_UART_RX_BUF_LEN
            int
            prompt "Buffer length for receiving console commands"
            default 2048
            help
                help text here

        config JOLT_CONSOLE_UART_TX_BUF_LEN
            int
            prompt "Buffer length for transmitting back console drawing"
            default 0
            help
                Set to 0 to block until command sent

        config JOLT_CONSOLE_MAX_ARGS
            int
            prompt "Maximum number of arguments to parse"
            default 8
            help
                help text here

        config JOLT_CONSOLE_MAX_CMD_LEN
            int
            prompt "Maximum length in characters of a command"
            default 4096
            help
                help text here

        config JOLT_CONSOLE_HISTORY
            int
            prompt "Number of previous commands to keep in history"
            default 12
            help
                help text here

        config JOLT_CONSOLE_OVERRIDE_LOGGING
            bool
            prompt "Disable ESP_LOG while console is running"
            default n
            help
                help text here
    endmenu

    menu "Task Stack Size"
        config JOLT_TASK_STACK_SIZE_CLI_DISPATCHER
            int
            prompt "CLI Dispatcher Task Stack Size"
            default 2560
            help
                help text here

        config JOLT_TASK_STACK_SIZE_LVGL
            int
            prompt "LittleVGL Task Stack Size"
            default 5008
            help
                help text here

        config JOLT_TASK_STACK_SIZE_VAULT_WATCHDOG
            int
            prompt "Vault Watchdog Task Stack Size"
            default 1792
            help
                Stack size of the task responsibility for vault timeout.

        config JOLT_TASK_STACK_SIZE_UART_CONSOLE
            int
            prompt "UART Linenoise Console Task Stack Size"
            default 3072
            help
                Task that receives UART CLI commands and sends them to BG as a job.

        config JOLT_TASK_STACK_SIZE_BLE_CONSOLE
            int
            prompt "BLE Linenoise Console Task Stack Size"
            default 3520
            help
                Task that receives BLE CLI commands and sends them to BG as a job.

        config JOLT_TASK_STACK_SIZE_BACKGROUND
            int
            prompt "Background Stack Size"
            default 6144
            help
                Primary task of executing any lengthy function to not block the GUI loop.

    endmenu

    menu "Task Priority"
        config JOLT_TASK_PRIORITY_CLI_DISPATCHER
            int
            prompt "CLI Dispatcher Task Priority"
            default 6
            range 1 20
            help
                help text here.

   
        config JOLT_TASK_PRIORITY_LVGL
            int
            prompt "LittleVGL Task Priority"
            default 17
            range 1 20
            help
                help text here.

        config JOLT_TASK_PRIORITY_UART_CONSOLE
            int
            prompt "UART Console Task Priority"
            default 15
            range 1 20
            help
                help text here.

        config JOLT_TASK_PRIORITY_BLE_CONSOLE
            int
            prompt "BLE Console Task Priority"
            default 15
            range 1 20
            help
                help text here.

        config JOLT_TASK_PRIORITY_LAUNCHER
            int
            prompt "App Launcher Task Priority"
            default 10
            range 1 20
            help
                help text here.

        config JOLT_TASK_PRIORITY_VAULT_WATCHDOG
            int
            prompt "Vault Watchdog Task Priority"
            default 16
            range 1 20
            help
                help text here.

        config JOLT_TASK_PRIORITY_BACKGROUND
            int
            prompt "Background Task Priority"
            default 3
            range 1 20
            help
                Must be lower than BLE_CONSOLE and UART_CONSOLE

    endmenu

    menu "WiFi"
        config AP_TARGET_SSID
            string
            prompt "WiFi SSID"
            default "SSID"
            help
                Factory reset WiFi ssid

        config AP_TARGET_PASSWORD
            string
            prompt "WiFi Password"
            default "Password"
            help
                Factory reset WiFi pass

        config JOLT_WIFI_ENABLE_DEFAULT
            bool
            prompt "Enable wifi by default?"
            default y
            help
                On first boost, enable/disable wifi.

        menu "Jolt Cast"
            config JOLT_CAST_URI
                string
                prompt "Jolt Cast Default URI"
                default "https://yapraiwallet.space/quake/api"
                help
                    Help Text Here
        endmenu
    endmenu

    menu "Bluetooth"
        config JOLT_BT_ENABLE_DEFAULT
            bool
            prompt "Enable bluetooth by default?"
            default y
            help
                On first boost, enable/disable bluetooth.

        config JOLT_BT_DEBUG_ALWAYS_ADV
             bool
             prompt "[DEBUG] Always advertise"
             default n
             help
                 Always advertise; for debugging purposes only. Not enabled for production.

        config JOLT_BT_YMODEM_PROFILING
             bool
             prompt "Profile ymodem transfers"
             default n
             help
                 Profile ymodem transfers.

        config JOLT_BT_PROFILING
             bool
             prompt "Profile bluetooth internals"
             default n
             help
                 Profile bluetooth internals.
    endmenu

    menu "Battery"
        config JOLT_VBATT_SENSE_PIN
            int
            prompt "PIN to 1/2 voltage divider of VBATT"
            default 32
            range 32 39
            help
                ADC1 GPIO pin that reads VBATT via a 1/2 voltage divider.

        config JOLT_VBATT_MIN
            int
            prompt "Raw ADC value to be considered 0 percent"
            default 2000
            help
                help text here

        config JOLT_VBATT_MAX
            int
            prompt "Raw ADC value to be considered 100 percent"
            default 2470
            help
                help text here

        config JOLT_VBATT_AVG_WINDOW
            int
            prompt "Number of battery readings to average over"
            default 10
            range 1 255
            help
                To provide smoother battery voltage readings, we take many 
                and average them.

    endmenu

    menu "Application Loader"
        config JELFLOADER_PROFILER_EN
            bool
            prompt "Enable ELF Loader Profiling"
            default n
            help
                Enable profiling tools. Takes up additional memory and some CPU cycles.

        config JOLT_APP_SIG_CHECK_EN
            bool
            prompt "Require applications to have a valid signature prior to launching"
            default y
            help
                help text here

        config JELFLOADER_INPUTBUF_LEN
            int
            prompt "Amount in bytes to read from disk at a time while loading an app"
            default 256
            help
                Increasing this buffer directly increases memory usage and load
                performance. In this use case, SPIFFS performance seems to 
                plateu at 256 bytes.

        config JOLT_APP_KEY_DEFAULT
            depends on JOLT_APP_SIG_CHECK_EN
            string
            prompt "Default Application Public Key"
            default "03a107bff3ce10be1d70dd18e74bc09967e4d6309ba50d5f1ddc8664125531b8"
            help
                Only launch apps with signatures that match this public key.
    endmenu

    menu "PIN Entry"
        choice
            prompt "Title for PIN Entry"
            config JOLT_PIN_TITLE_PIN
                bool "Simply titled PIN"
                help
                   help text here
            config JOLT_PIN_TITLE_NAME
                bool "App name in title"
                help
                   help text here
            config JOLT_PIN_TITLE_PATH
                bool "Derivation Path in Title"
                help
                   help text here
        endchoice

        config JOLT_PIN_DEFAULT_MAX_ATTEMPT
            int
            prompt "Number of pin attempts before wiping NVS"
            default 10
            help
                help text here
    endmenu

    menu "Language"
		choice
            prompt "Select Default Language"

            config JOLT_LANG_DEFAULT_ENGLISH
                depends on JOLT_LANG_ENGLISH_EN
                bool "English"
            config JOLT_LANG_DEFAULT_SPANISH
                depends on JOLT_LANG_SPANISH_EN
                bool "Spanish"

        endchoice

        config JOLT_LANG_DEFAULT
            int
            # Make sure these values match jolt_language_t in lang/lang.h 
            default 0
            default 0 if JOLT_LANG_DEFAULT_ENGLISH
            default 1 if JOLT_LANG_DEFAULT_SPANISH

        config JOLT_LANG_ENGLISH_EN
            bool
            prompt "Enable English Support"
            default y

        config JOLT_LANG_SPANISH_EN
            bool
            prompt "Enable Spanish Support"
            default y

    endmenu

    config JOLT_BOOTLOADER_CHECK
        bool
        prompt "Enable Bootloader Hash check"
        default n

    config JOLT_TABLE_CHECK
        bool
        prompt "Enable Partition Table Hash check"
        default n

    menu "Filesystem"
        choice
            prompt "Driver"
            config JOLT_FS_LITTLEFS
                bool "Use LittleFS Filesystem"
                help
                    Use LittleFS for the filesystem.
            config JOLT_FS_SPIFFS
                bool "Use SPIFFS Filesystem"
                help
                    Use SPIFFS for the filesystem.
            config JOLT_FS_FAT
                bool "Use FAT Filesystem"
                help
                    Use FAT for the filesystem.
        endchoice
    endmenu

endmenu
```
