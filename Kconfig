## sdkconfigs/sdkconfig.defaults
```kconfig
#
# Things that need to change before consumer release
#
CONFIG_BOOTLOADER_LOG_LEVEL=2
CONFIG_BOOTLOADER_LOG_LEVEL_WARN=y

#
# Application manager
#

# Disabled so that builds have deterministic hashes
CONFIG_APP_COMPILE_TIME_DATE=n

#
# Bootloader config
#
CONFIG_BOOTLOADER_EFUSE_SECURE_VERSION_EMULATE=y
CONFIG_BOOTLOADER_APP_ROLLBACK_ENABLE=y
CONFIG_BOOTLOADER_APP_ANTI_ROLLBACK=y
CONFIG_BOOTLOADER_APP_SECURE_VERSION=0
CONFIG_BOOTLOADER_APP_SEC_VER_SIZE_EFUSE_FIELD=32

#
# Security features
#

#
# Serial flasher config
#
CONFIG_ESPTOOLPY_BAUD_921600B=y
CONFIG_ESPTOOLPY_COMPRESSED=y
CONFIG_ESPTOOLPY_FLASHMODE_QIO=y
CONFIG_ESPTOOLPY_FLASHFREQ_80M=y
CONFIG_ESPTOOLPY_FLASHFREQ="80m"
CONFIG_ESPTOOLPY_FLASHSIZE_4MB=y
CONFIG_ESPTOOLPY_FLASHSIZE="4MB"
CONFIG_ESPTOOLPY_BEFORE_RESET=y
CONFIG_ESPTOOLPY_BEFORE="default_reset"
CONFIG_ESPTOOLPY_AFTER_RESET=y
CONFIG_ESPTOOLPY_AFTER_NORESET=n
CONFIG_ESPTOOLPY_AFTER="hard_reset"
CONFIG_ESPTOOLPY_MONITOR_BAUD_OTHER=y
CONFIG_ESPTOOLPY_MONITOR_BAUD_OTHER_VAL=230400

#
# Partition Table
#
CONFIG_PARTITION_TABLE_CUSTOM=y
CONFIG_PARTITION_TABLE_CUSTOM_FILENAME="partitions.csv"
CONFIG_PARTITION_TABLE_FILENAME="partitions.csv"
CONFIG_PARTITION_TABLE_OFFSET=0x8000
CONFIG_PARTITION_TABLE_MD5=y

#
# Compiler options
#
CONFIG_COMPILER_OPTIMIZATION_SIZE=y
CONFIG_COMPILER_OPTIMIZATION_ASSERTIONS_SILENT=y
CONFIG_COMPILER_STACK_CHECK_MODE_ALL=y

#
# Component config
#

#
# Application Level Tracing
#

#
# BIP Mnemonic
#

#
# Bluetooth
#
CONFIG_BT_ENABLED=y

#
# Bluetooth controller
#
CONFIG_BTDM_CTRL_MODE_BLE_ONLY=y
CONFIG_BTDM_CTRL_MODE_BR_EDR_ONLY=n
CONFIG_BTDM_CTRL_MODE_BTDM=n
CONFIG_BTDM_CTRL_BLE_MAX_CONN=3
CONFIG_BTDM_CTRL_BLE_MAX_CONN_EFF=3
CONFIG_BTDM_CTRL_BR_EDR_MAX_ACL_CONN_EFF=0
CONFIG_BTDM_CTRL_BR_EDR_MAX_SYNC_CONN_EFF=0
CONFIG_BTDM_CTRL_PINNED_TO_CORE_0=y
CONFIG_BTDM_CTRL_PINNED_TO_CORE_1=n
CONFIG_BTDM_CTRL_PINNED_TO_CORE=0
CONFIG_BTDM_CTRL_HCI_MODE_VHCI=y
CONFIG_BTDM_CTRL_HCI_MODE_UART_H4=n

#
# Bluetooth (nimBLE)
#
CONFIG_BT_NIMBLE_ENABLED=y
CONFIG_BT_NIMBLE_SVC_GAP_DEVICE_NAME="Jolt"
CONFIG_BT_NIMBLE_DEBUG=n
CONFIG_BT_NIMBLE_MAX_CONNECTIONS=1
CONFIG_BT_NIMBLE_MAX_BONDS=5
CONFIG_BT_NIMBLE_L2CAP_COC_MAX_NUM=0
CONFIG_BT_NIMBLE_TASK_STACK_SIZE=5120
CONFIG_BT_NIMBLE_ROLE_CENTRAL=n
CONFIG_BT_NIMBLE_ROLE_PERIPHERAL=y
CONFIG_BT_NIMBLE_ROLE_BROADCASTER=n
CONFIG_BT_NIMBLE_ROLE_OBSERVER=n
CONFIG_BT_NIMBLE_NVS_PERSIST=y
CONFIG_BT_NIMBLE_SM_LEGACY=n
CONFIG_BT_NIMBLE_SM_SC=y
CONFIG_BT_NIMBLE_PINNED_TO_CORE_1=y

#
# MODEM SLEEP Options
#
CONFIG_BTDM_MODEM_SLEEP=y
CONFIG_BTDM_MODEM_SLEEP_MODE_ORIG=y
CONFIG_BTDM_MODEM_SLEEP_MODE_EVED=n
CONFIG_BTDM_LPCLK_SEL_MAIN_XTAL=y
CONFIG_BTDM_BLE_SCAN_DUPL=y
CONFIG_BTDM_SCAN_DUPL_TYPE_DEVICE=y
CONFIG_BTDM_SCAN_DUPL_TYPE_DATA=n
CONFIG_BTDM_SCAN_DUPL_TYPE_DATA_AND_DEVICE_ADDR=n
CONFIG_BTDM_SCAN_DUPL_TYPE=0
CONFIG_BTDM_SCAN_DUPL_CACHE_SIZE=200
CONFIG_BTDM_BLE_MESH_SCAN_DUPL_EN=n
CONFIG_BTDM_CTRL_FULL_SCAN_SUPPORTED=n
CONFIG_BT_BTC_TASK_STACK_SIZE=2880
CONFIG_BT_BTU_TASK_STACK_SIZE=3808
CONFIG_BT_CLASSIC_ENABLED=n
CONFIG_BT_GATTS_ENABLE=y
CONFIG_BT_GATTS_SEND_SERVICE_CHANGE_MANUAL=n
CONFIG_BT_GATTS_SEND_SERVICE_CHANGE_AUTO=y
CONFIG_BT_GATTS_SEND_SERVICE_CHANGE_MODE=0
CONFIG_BT_GATTC_ENABLE=y
CONFIG_BT_GATTC_CACHE_NVS_FLASH=n
CONFIG_BT_BLE_SMP_ENABLE=y
CONFIG_BT_STACK_NO_LOG=n

#
# BT DEBUG LOG LEVEL
#
CONFIG_BT_LOG_HCI_TRACE_LEVEL_NONE=n
CONFIG_BT_LOG_HCI_TRACE_LEVEL_ERROR=n
CONFIG_BT_LOG_HCI_TRACE_LEVEL_WARNING=y
CONFIG_BT_LOG_HCI_TRACE_LEVEL_API=n
CONFIG_BT_LOG_HCI_TRACE_LEVEL_EVENT=n
CONFIG_BT_LOG_HCI_TRACE_LEVEL_DEBUG=n
CONFIG_BT_LOG_HCI_TRACE_LEVEL_VERBOSE=n
CONFIG_BT_LOG_HCI_TRACE_LEVEL=2
CONFIG_BT_LOG_BTM_TRACE_LEVEL_NONE=n
CONFIG_BT_LOG_BTM_TRACE_LEVEL_ERROR=n
CONFIG_BT_LOG_BTM_TRACE_LEVEL_WARNING=y
CONFIG_BT_LOG_BTM_TRACE_LEVEL_API=n
CONFIG_BT_LOG_BTM_TRACE_LEVEL_EVENT=n
CONFIG_BT_LOG_BTM_TRACE_LEVEL_DEBUG=n
CONFIG_BT_LOG_BTM_TRACE_LEVEL_VERBOSE=n
CONFIG_BT_LOG_BTM_TRACE_LEVEL=2
CONFIG_BT_LOG_L2CAP_TRACE_LEVEL_NONE=n
CONFIG_BT_LOG_L2CAP_TRACE_LEVEL_ERROR=n
CONFIG_BT_LOG_L2CAP_TRACE_LEVEL_WARNING=y
CONFIG_BT_LOG_L2CAP_TRACE_LEVEL_API=n
CONFIG_BT_LOG_L2CAP_TRACE_LEVEL_EVENT=n
CONFIG_BT_LOG_L2CAP_TRACE_LEVEL_DEBUG=n
CONFIG_BT_LOG_L2CAP_TRACE_LEVEL_VERBOSE=n
CONFIG_BT_LOG_L2CAP_TRACE_LEVEL=2
CONFIG_BT_LOG_RFCOMM_TRACE_LEVEL_NONE=n
CONFIG_BT_LOG_RFCOMM_TRACE_LEVEL_ERROR=n
CONFIG_BT_LOG_RFCOMM_TRACE_LEVEL_WARNING=y
CONFIG_BT_LOG_RFCOMM_TRACE_LEVEL_API=n
CONFIG_BT_LOG_RFCOMM_TRACE_LEVEL_EVENT=n
CONFIG_BT_LOG_RFCOMM_TRACE_LEVEL_DEBUG=n
CONFIG_BT_LOG_RFCOMM_TRACE_LEVEL_VERBOSE=n
CONFIG_BT_LOG_RFCOMM_TRACE_LEVEL=2
CONFIG_BT_LOG_SDP_TRACE_LEVEL_NONE=n
CONFIG_BT_LOG_SDP_TRACE_LEVEL_ERROR=n
CONFIG_BT_LOG_SDP_TRACE_LEVEL_WARNING=y
CONFIG_BT_LOG_SDP_TRACE_LEVEL_API=n
CONFIG_BT_LOG_SDP_TRACE_LEVEL_EVENT=n
CONFIG_BT_LOG_SDP_TRACE_LEVEL_DEBUG=n
CONFIG_BT_LOG_SDP_TRACE_LEVEL_VERBOSE=n
CONFIG_SDP_INITIAL_TRACE_LEVEL=2
CONFIG_BT_LOG_GAP_TRACE_LEVEL_NONE=n
CONFIG_BT_LOG_GAP_TRACE_LEVEL_ERROR=n
CONFIG_BT_LOG_GAP_TRACE_LEVEL_WARNING=y
CONFIG_BT_LOG_GAP_TRACE_LEVEL_API=n
CONFIG_BT_LOG_GAP_TRACE_LEVEL_EVENT=n
CONFIG_BT_LOG_GAP_TRACE_LEVEL_DEBUG=n
CONFIG_BT_LOG_GAP_TRACE_LEVEL_VERBOSE=n
CONFIG_BT_LOG_GAP_TRACE_LEVEL=2
CONFIG_BNEP_TRACE_LEVEL_NONE=n
CONFIG_BNEP_TRACE_LEVEL_ERROR=n
CONFIG_BNEP_TRACE_LEVEL_WARNING=y
CONFIG_BNEP_TRACE_LEVEL_API=n
CONFIG_BNEP_TRACE_LEVEL_EVENT=n
CONFIG_BNEP_TRACE_LEVEL_DEBUG=n
CONFIG_BNEP_TRACE_LEVEL_VERBOSE=n
CONFIG_BT_LOG_BNEP_TRACE_LEVEL=2
CONFIG_BT_LOG_PAN_TRACE_LEVEL_NONE=n
CONFIG_BT_LOG_PAN_TRACE_LEVEL_ERROR=n
CONFIG_BT_LOG_PAN_TRACE_LEVEL_WARNING=y
CONFIG_BT_LOG_PAN_TRACE_LEVEL_API=n
CONFIG_BT_LOG_PAN_TRACE_LEVEL_EVENT=n
CONFIG_BT_LOG_PAN_TRACE_LEVEL_DEBUG=n
CONFIG_BT_LOG_PAN_TRACE_LEVEL_VERBOSE=n
CONFIG_BT_LOG_PAN_TRACE_LEVEL=2
CONFIG_BT_LOG_A2D_TRACE_LEVEL_NONE=n
CONFIG_BT_LOG_A2D_TRACE_LEVEL_ERROR=n
CONFIG_BT_LOG_A2D_TRACE_LEVEL_WARNING=y
CONFIG_BT_LOG_A2D_TRACE_LEVEL_API=n
CONFIG_BT_LOG_A2D_TRACE_LEVEL_EVENT=n
CONFIG_BT_LOG_A2D_TRACE_LEVEL_DEBUG=n
CONFIG_BT_LOG_A2D_TRACE_LEVEL_VERBOSE=n
CONFIG_BT_LOG_A2D_TRACE_LEVEL=2
CONFIG_BT_LOG_AVDT_TRACE_LEVEL_NONE=n
CONFIG_BT_LOG_AVDT_TRACE_LEVEL_ERROR=n
CONFIG_BT_LOG_AVDT_TRACE_LEVEL_WARNING=y
CONFIG_BT_LOG_AVDT_TRACE_LEVEL_API=n
CONFIG_BT_LOG_AVDT_TRACE_LEVEL_EVENT=n
CONFIG_BT_LOG_AVDT_TRACE_LEVEL_DEBUG=n
CONFIG_BT_LOG_AVDT_TRACE_LEVEL_VERBOSE=n
CONFIG_BT_LOG_AVDT_TRACE_LEVEL=2
CONFIG_BT_LOG_AVCT_TRACE_LEVEL_NONE=n
CONFIG_BT_LOG_AVCT_TRACE_LEVEL_ERROR=n
CONFIG_BT_LOG_AVCT_TRACE_LEVEL_WARNING=y
CONFIG_BT_LOG_AVCT_TRACE_LEVEL_API=n
CONFIG_BT_LOG_AVCT_TRACE_LEVEL_EVENT=n
CONFIG_BT_LOG_AVCT_TRACE_LEVEL_DEBUG=n
CONFIG_BT_LOG_AVCT_TRACE_LEVEL_VERBOSE=n
CONFIG_BT_LOG_AVCT_TRACE_LEVEL=2
CONFIG_BT_LOG_AVRC_TRACE_LEVEL_NONE=n
CONFIG_BT_LOG_AVRC_TRACE_LEVEL_ERROR=n
CONFIG_BT_LOG_AVRC_TRACE_LEVEL_WARNING=y
CONFIG_BT_LOG_AVRC_TRACE_LEVEL_API=n
CONFIG_BT_LOG_AVRC_TRACE_LEVEL_EVENT=n
CONFIG_BT_LOG_AVRC_TRACE_LEVEL_DEBUG=n
CONFIG_BT_LOG_AVRC_TRACE_LEVEL_VERBOSE=n
CONFIG_BT_LOG_AVRC_TRACE_LEVEL=2
CONFIG_BT_LOG_MCA_TRACE_LEVEL_NONE=n
CONFIG_BT_LOG_MCA_TRACE_LEVEL_ERROR=n
CONFIG_BT_LOG_MCA_TRACE_LEVEL_WARNING=y
CONFIG_BT_LOG_MCA_TRACE_LEVEL_API=n
CONFIG_BT_LOG_MCA_TRACE_LEVEL_EVENT=n
CONFIG_BT_LOG_MCA_TRACE_LEVEL_DEBUG=n
CONFIG_BT_LOG_MCA_TRACE_LEVEL_VERBOSE=n
CONFIG_BT_LOG_MCA_TRACE_LEVEL=2
CONFIG_BT_LOG_HID_TRACE_LEVEL_NONE=n
CONFIG_BT_LOG_HID_TRACE_LEVEL_ERROR=n
CONFIG_BT_LOG_HID_TRACE_LEVEL_WARNING=y
CONFIG_BT_LOG_HID_TRACE_LEVEL_API=n
CONFIG_BT_LOG_HID_TRACE_LEVEL_EVENT=n
CONFIG_BT_LOG_HID_TRACE_LEVEL_DEBUG=n
CONFIG_BT_LOG_HID_TRACE_LEVEL_VERBOSE=n
CONFIG_BT_LOG_HID_TRACE_LEVEL=2
CONFIG_BT_LOG_APPL_TRACE_LEVEL_NONE=n
CONFIG_BT_LOG_APPL_TRACE_LEVEL_ERROR=n
CONFIG_BT_LOG_APPL_TRACE_LEVEL_WARNING=y
CONFIG_BT_LOG_APPL_TRACE_LEVEL_API=n
CONFIG_BT_LOG_APPL_TRACE_LEVEL_EVENT=n
CONFIG_BT_LOG_APPL_TRACE_LEVEL_DEBUG=n
CONFIG_BT_LOG_APPL_TRACE_LEVEL_VERBOSE=n
CONFIG_BT_LOG_APPL_TRACE_LEVEL=2
CONFIG_BT_LOG_GATT_TRACE_LEVEL_NONE=n
CONFIG_BT_LOG_GATT_TRACE_LEVEL_ERROR=n
CONFIG_BT_LOG_GATT_TRACE_LEVEL_WARNING=y
CONFIG_BT_LOG_GATT_TRACE_LEVEL_API=n
CONFIG_BT_LOG_GATT_TRACE_LEVEL_EVENT=n
CONFIG_BT_LOG_GATT_TRACE_LEVEL_DEBUG=n
CONFIG_BT_LOG_GATT_TRACE_LEVEL_VERBOSE=n
CONFIG_BT_LOG_GATT_TRACE_LEVEL=2
CONFIG_BT_LOG_SMP_TRACE_LEVEL_NONE=n
CONFIG_BT_LOG_SMP_TRACE_LEVEL_ERROR=n
CONFIG_BT_LOG_SMP_TRACE_LEVEL_WARNING=y
CONFIG_BT_LOG_SMP_TRACE_LEVEL_API=n
CONFIG_BT_LOG_SMP_TRACE_LEVEL_EVENT=n
CONFIG_BT_LOG_SMP_TRACE_LEVEL_DEBUG=n
CONFIG_BT_LOG_SMP_TRACE_LEVEL_VERBOSE=n
CONFIG_BT_LOG_SMP_TRACE_LEVEL=2
CONFIG_BT_LOG_BTIF_TRACE_LEVEL_NONE=n
CONFIG_BT_LOG_BTIF_TRACE_LEVEL_ERROR=n
CONFIG_BT_LOG_BTIF_TRACE_LEVEL_WARNING=y
CONFIG_BT_LOG_BTIF_TRACE_LEVEL_API=n
CONFIG_BT_LOG_BTIF_TRACE_LEVEL_EVENT=n
CONFIG_BT_LOG_BTIF_TRACE_LEVEL_DEBUG=n
CONFIG_BT_LOG_BTIF_TRACE_LEVEL_VERBOSE=n
CONFIG_BT_LOG_BTIF_TRACE_LEVEL=2
CONFIG_BT_LOG_BTC_TRACE_LEVEL_NONE=n
CONFIG_BT_LOG_BTC_TRACE_LEVEL_ERROR=n
CONFIG_BT_LOG_BTC_TRACE_LEVEL_WARNING=y
CONFIG_BT_LOG_BTC_TRACE_LEVEL_API=n
CONFIG_BT_LOG_BTC_TRACE_LEVEL_EVENT=n
CONFIG_BT_LOG_BTC_TRACE_LEVEL_DEBUG=n
CONFIG_BT_LOG_BTC_TRACE_LEVEL_VERBOSE=n
CONFIG_BT_LOG_BTC_TRACE_LEVEL=2
CONFIG_BT_LOG_OSI_TRACE_LEVEL_NONE=n
CONFIG_BT_LOG_OSI_TRACE_LEVEL_ERROR=n
CONFIG_BT_LOG_OSI_TRACE_LEVEL_WARNING=y
CONFIG_BT_LOG_OSI_TRACE_LEVEL_API=n
CONFIG_BT_LOG_OSI_TRACE_LEVEL_EVENT=n
CONFIG_BT_LOG_OSI_TRACE_LEVEL_DEBUG=n
CONFIG_BT_LOG_OSI_TRACE_LEVEL_VERBOSE=n
CONFIG_BT_LOG_OSI_TRACE_LEVEL=2
CONFIG_BT_LOG_BLUFI_TRACE_LEVEL_NONE=n
CONFIG_BT_LOG_BLUFI_TRACE_LEVEL_ERROR=n
CONFIG_BT_LOG_BLUFI_TRACE_LEVEL_WARNING=y
CONFIG_BT_LOG_BLUFI_TRACE_LEVEL_API=n
CONFIG_BT_LOG_BLUFI_TRACE_LEVEL_EVENT=n
CONFIG_BT_LOG_BLUFI_TRACE_LEVEL_DEBUG=n
CONFIG_BT_LOG_BLUFI_TRACE_LEVEL_VERBOSE=n
CONFIG_BT_LOG_BLUFI_TRACE_LEVEL=2
CONFIG_BT_ACL_CONNECTIONS=4
CONFIG_BT_ALLOCATION_FROM_SPIRAM_FIRST=n
CONFIG_BT_BLE_DYNAMIC_ENV_MEMORY=n
CONFIG_BT_BLE_HOST_QUEUE_CONG_CHECK=n
CONFIG_BT_SMP_ENABLE=y
CONFIG_BT_RESERVE_DRAM=0xdb5c

#
# Driver configurations
#

#
# ADC configuration
#
CONFIG_ADC_FORCE_XPD_FSM=y


#
# SPI configuration
#
CONFIG_SPI_MASTER_IN_IRAM=y
CONFIG_SPI_MASTER_ISR_IN_IRAM=y
CONFIG_SPI_SLAVE_IN_IRAM=n
CONFIG_SPI_SLAVE_ISR_IN_IRAM=y

#
# Easy_Input Config
#
CONFIG_EASY_INPUT_VOLATILE=y

#
# Push Buttons
#
CONFIG_EASY_INPUT_PUSH_BUTTON_ENABLE=n

#
# Touch
#
CONFIG_EASY_INPUT_TOUCH_ENABLE=y
CONFIG_EASY_INPUT_TOUCH_UP_PIN=7
CONFIG_EASY_INPUT_TOUCH_DOWN_PIN=6
CONFIG_EASY_INPUT_TOUCH_LEFT_PIN=-1
CONFIG_EASY_INPUT_TOUCH_RIGHT_PIN=-1
CONFIG_EASY_INPUT_TOUCH_BACK_PIN=5
CONFIG_EASY_INPUT_TOUCH_ENTER_PIN=8
CONFIG_EASY_INPUT_TOUCH_FILTER_PERIOD_MS=10
CONFIG_EASY_INPUT_TOUCH_THRESH_PERCENT=750
CONFIG_EASY_INPUT_TOUCH_PERIOD=33
CONFIG_EASY_INPUT_HOLD_ENABLE=y
CONFIG_EASY_INPUT_HOLD_SLOW_DELAY=12
CONFIG_EASY_INPUT_HOLD_FAST_DELAY=24
CONFIG_EASY_INPUT_HOLD_SLOW_PERIOD=6
CONFIG_EASY_INPUT_HOLD_FAST_PERIOD=2
CONFIG_EASY_INPUT_QUEUE=n
CONFIG_EASY_INPUT_VOLATILE=y

#
# ESP32-specific
#
CONFIG_IDF_TARGET_ESP32=y
CONFIG_ESP32_DEFAULT_CPU_FREQ_240=y
CONFIG_ESP32_DEFAULT_CPU_FREQ_MHZ=240

#
# Core dump
#
CONFIG_ESP32_ENABLE_COREDUMP_TO_FLASH=n
CONFIG_ESP32_ENABLE_COREDUMP_TO_UART=n
CONFIG_ESP32_ENABLE_COREDUMP_TO_NONE=y
CONFIG_ESP32_ENABLE_COREDUMP=n
CONFIG_ESP32_UNIVERSAL_MAC_ADDRESSES_TWO=n
CONFIG_ESP32_UNIVERSAL_MAC_ADDRESSES_FOUR=y
CONFIG_ESP32_UNIVERSAL_MAC_ADDRESSES=4
CONFIG_ESP_SYSTEM_EVENT_QUEUE_SIZE=16
CONFIG_ESP_SYSTEM_EVENT_TASK_STACK_SIZE=1920
CONFIG_ESP_MAIN_TASK_STACK_SIZE=4096
CONFIG_ESP_IPC_TASK_STACK_SIZE=832
CONFIG_ESP_TIMER_TASK_STACK_SIZE=2048
CONFIG_NEWLIB_STDOUT_LINE_ENDING_CRLF=n
CONFIG_NEWLIB_STDOUT_LINE_ENDING_LF=y
CONFIG_NEWLIB_STDOUT_LINE_ENDING_CR=n
CONFIG_NEWLIB_STDIN_LINE_ENDING_CRLF=n
CONFIG_NEWLIB_STDIN_LINE_ENDING_LF=n
CONFIG_NEWLIB_STDIN_LINE_ENDING_CR=y
CONFIG_NEWLIB_NANO_FORMAT=y
CONFIG_ESP_CONSOLE_UART_DEFAULT=y
CONFIG_ESP_CONSOLE_UART_CUSTOM=n
CONFIG_ESP_CONSOLE_UART_NONE=n
CONFIG_ESP_CONSOLE_UART_NUM=0
CONFIG_ESP_CONSOLE_UART_BAUDRATE=230400
CONFIG_ESP32_ULP_COPROC_ENABLED=n
CONFIG_ESP32_ULP_COPROC_RESERVE_MEM=0
CONFIG_ESP_PANIC_PRINT_HALT=n
CONFIG_ESP_PANIC_PRINT_REBOOT=y
CONFIG_ESP_PANIC_SILENT_REBOOT=n
CONFIG_ESP_PANIC_GDBSTUB=n
CONFIG_ESP32_DEBUG_OCDAWARE=y
CONFIG_ESP_DEBUG_STUBS_ENABLE=y
CONFIG_ESP_INT_WDT=y
CONFIG_ESP_INT_WDT_TIMEOUT_MS=5000
CONFIG_ESP_INT_WDT_CHECK_CPU1=y
CONFIG_ESP_TASK_WDT=y
CONFIG_ESP_TASK_WDT_PANIC=n
CONFIG_ESP_TASK_WDT_TIMEOUT_S=15
CONFIG_ESP_TASK_WDT_CHECK_IDLE_TASK_CPU0=y
CONFIG_ESP_TASK_WDT_CHECK_IDLE_TASK_CPU1=y
CONFIG_ESP32_BROWNOUT_DET=y
CONFIG_ESP32_BROWNOUT_DET_LVL_SEL_0=y
CONFIG_ESP32_BROWNOUT_DET_LVL_SEL_1=n
CONFIG_ESP32_BROWNOUT_DET_LVL_SEL_2=n
CONFIG_ESP32_BROWNOUT_DET_LVL_SEL_3=n
CONFIG_ESP32_BROWNOUT_DET_LVL_SEL_4=n
CONFIG_ESP32_BROWNOUT_DET_LVL_SEL_5=n
CONFIG_ESP32_BROWNOUT_DET_LVL_SEL_6=n
CONFIG_ESP32_BROWNOUT_DET_LVL_SEL_7=n
CONFIG_ESP32_BROWNOUT_DET_LVL=0
CONFIG_ESP32_REDUCE_PHY_TX_POWER=y
CONFIG_ESP32_TIME_SYSCALL_USE_RTC_FRC1=y
CONFIG_ESP32_TIME_SYSCALL_USE_RTC=n
CONFIG_ESP32_TIME_SYSCALL_USE_FRC1=n
CONFIG_ESP32_TIME_SYSCALL_USE_NONE=n
CONFIG_ESP32_RTC_CLK_SRC_INT_RC=y
CONFIG_ESP32_RTC_CLK_SRC_EXT_CRYS=n
CONFIG_ESP32_RTC_CLK_SRC_EXT_OSC=n
CONFIG_ESP32_RTC_CLK_SRC_INT_8MD256=n
CONFIG_ESP32_RTC_CLK_CAL_CYCLES=1024
CONFIG_ESP32_DEEP_SLEEP_WAKEUP_DELAY=2000
CONFIG_ESP32_XTAL_FREQ_40=n
CONFIG_ESP32_XTAL_FREQ_26=n
CONFIG_ESP32_XTAL_FREQ_AUTO=y
CONFIG_ESP32_XTAL_FREQ=0
CONFIG_ESP32_DISABLE_BASIC_ROM_CONSOLE=n
CONFIG_ESP_TIMER_PROFILING=n
CONFIG_ESP32_COMPATIBLE_PRE_V2_1_BOOTLOADERS=n
CONFIG_ESP_ERR_TO_NAME_LOOKUP=y

#
# Wi-Fi
#
CONFIG_ESP32_WIFI_SW_COEXIST_ENABLE=y
CONFIG_ESP32_WIFI_SW_COEXIST_PREFERENCE_WIFI=n
CONFIG_ESP32_WIFI_SW_COEXIST_PREFERENCE_BT=n
CONFIG_ESP32_WIFI_SW_COEXIST_PREFERENCE_BALANCE=y
CONFIG_ESP32_WIFI_SW_COEXIST_PREFERENCE_VALUE=2
CONFIG_ESP32_WIFI_STATIC_RX_BUFFER_NUM=3
CONFIG_ESP32_WIFI_DYNAMIC_RX_BUFFER_NUM=4
CONFIG_ESP32_WIFI_STATIC_TX_BUFFER=n
CONFIG_ESP32_WIFI_DYNAMIC_TX_BUFFER=y
CONFIG_ESP32_WIFI_TX_BUFFER_TYPE=1
CONFIG_ESP32_WIFI_DYNAMIC_TX_BUFFER_NUM=16
CONFIG_ESP32_WIFI_CSI_ENABLED=n
CONFIG_ESP32_WIFI_AMPDU_TX_ENABLED=y
CONFIG_ESP32_WIFI_TX_BA_WIN=6
CONFIG_ESP32_WIFI_AMPDU_RX_ENABLED=y
CONFIG_ESP32_WIFI_RX_BA_WIN=4
CONFIG_ESP32_WIFI_NVS_ENABLED=y
CONFIG_ESP32_WIFI_TASK_PINNED_TO_CORE_0=y
CONFIG_ESP32_WIFI_TASK_PINNED_TO_CORE_1=n
CONFIG_ESP32_WIFI_SOFTAP_BEACON_MAX_LEN=752
CONFIG_ESP32_WIFI_DEBUG_LOG_ENABLE=n
CONFIG_ESP32_WIFI_IRAM_OPT=n
CONFIG_ESP32_WIFI_RX_IRAM_OPT=n

#
# PHY
#
CONFIG_ESP32_PHY_CALIBRATION_AND_DATA_STORAGE=y
CONFIG_ESP32_PHY_INIT_DATA_IN_PARTITION=n
CONFIG_ESP32_PHY_MAX_WIFI_TX_POWER=20
CONFIG_ESP32_PHY_MAX_TX_POWER=20

#
# Power Management
#
CONFIG_PM_ENABLE=y
CONFIG_PM_PROFILING=y

#
# ADC-Calibration
#
CONFIG_ADC_CAL_EFUSE_TP_ENABLE=y
CONFIG_ADC_CAL_EFUSE_VREF_ENABLE=y
CONFIG_ADC_CAL_LUT_ENABLE=y
CONFIG_EFUSE_VIRTUAL=y

#
# Event Loop Library
#
CONFIG_ESP_EVENT_LOOP_PROFILING=n

#
# ESP HTTP client
#
CONFIG_ESP_HTTP_CLIENT_ENABLE_HTTPS=y

#
# HTTP Server
#
CONFIG_HTTPD_MAX_REQ_HDR_LEN=512
CONFIG_HTTPD_MAX_URI_LEN=512

#
# Ethernet
#
CONFIG_DMA_RX_BUF_NUM=10
CONFIG_DMA_TX_BUF_NUM=10
CONFIG_EMAC_L2_TO_L3_RX_BUF_MODE=n
CONFIG_EMAC_CHECK_LINK_PERIOD_MS=2000
CONFIG_EMAC_TASK_PRIORITY=20
CONFIG_EMAC_TASK_STACK_SIZE=3072

#
# FAT Filesystem support
#
CONFIG_FATFS_CODEPAGE_DYNAMIC=n
CONFIG_FATFS_CODEPAGE_437=y
CONFIG_FATFS_CODEPAGE_720=n
CONFIG_FATFS_CODEPAGE_737=n
CONFIG_FATFS_CODEPAGE_771=n
CONFIG_FATFS_CODEPAGE_775=n
CONFIG_FATFS_CODEPAGE_850=n
CONFIG_FATFS_CODEPAGE_852=n
CONFIG_FATFS_CODEPAGE_855=n
CONFIG_FATFS_CODEPAGE_857=n
CONFIG_FATFS_CODEPAGE_860=n
CONFIG_FATFS_CODEPAGE_861=n
CONFIG_FATFS_CODEPAGE_862=n
CONFIG_FATFS_CODEPAGE_863=n
CONFIG_FATFS_CODEPAGE_864=n
CONFIG_FATFS_CODEPAGE_865=n
CONFIG_FATFS_CODEPAGE_866=n
CONFIG_FATFS_CODEPAGE_869=n
CONFIG_FATFS_CODEPAGE_932=n
CONFIG_FATFS_CODEPAGE_936=n
CONFIG_FATFS_CODEPAGE_949=n
CONFIG_FATFS_CODEPAGE_950=n
CONFIG_FATFS_CODEPAGE=437
CONFIG_FATFS_LFN_NONE=y
CONFIG_FATFS_LFN_HEAP=n
CONFIG_FATFS_LFN_STACK=n
CONFIG_FATFS_FS_LOCK=0
CONFIG_FATFS_TIMEOUT_MS=10000
CONFIG_FATFS_PER_FILE_CACHE=y

#
# Modbus configuration
#
CONFIG_FMB_QUEUE_LENGTH=20
CONFIG_FMB_SERIAL_TASK_STACK_SIZE=2048
CONFIG_FMB_SERIAL_BUF_SIZE=256
CONFIG_FMB_SERIAL_TASK_PRIO=10
CONFIG_FMB_CONTROLLER_SLAVE_ID_SUPPORT=n
CONFIG_FMB_CONTROLLER_NOTIFY_TIMEOUT=20
CONFIG_FMB_CONTROLLER_NOTIFY_QUEUE_SIZE=20
CONFIG_FMB_CONTROLLER_STACK_SIZE=4096
CONFIG_FMB_EVENT_QUEUE_TIMEOUT=20
CONFIG_FMB_TIMER_PORT_ENABLED=y
CONFIG_FMB_TIMER_GROUP=0
CONFIG_FMB_TIMER_INDEX=0

#
# FreeRTOS
#
CONFIG_FREERTOS_UNICORE=n
CONFIG_FREERTOS_NO_AFFINITY=0x7FFFFFFF
CONFIG_FREERTOS_CORETIMER_0=y
CONFIG_FREERTOS_CORETIMER_1=n
CONFIG_FREERTOS_HZ=200
CONFIG_FREERTOS_ASSERT_ON_UNTESTED_FUNCTION=y
CONFIG_FREERTOS_CHECK_STACKOVERFLOW_NONE=n
CONFIG_FREERTOS_CHECK_STACKOVERFLOW_PTRVAL=n
CONFIG_FREERTOS_CHECK_STACKOVERFLOW_CANARY=y
CONFIG_FREERTOS_WATCHPOINT_END_OF_STACK=n
CONFIG_FREERTOS_INTERRUPT_BACKTRACE=y
CONFIG_FREERTOS_THREAD_LOCAL_STORAGE_POINTERS=1
CONFIG_FREERTOS_ASSERT_FAIL_ABORT=y
CONFIG_FREERTOS_ASSERT_FAIL_PRINT_CONTINUE=n
CONFIG_FREERTOS_ASSERT_DISABLE=n
CONFIG_FREERTOS_IDLE_TASK_STACKSIZE=1024
CONFIG_FREERTOS_ISR_STACKSIZE=1536
CONFIG_FREERTOS_LEGACY_HOOKS=n
CONFIG_FREERTOS_MAX_TASK_NAME_LEN=16
CONFIG_FREERTOS_SUPPORT_STATIC_ALLOCATION=y
CONFIG_FREERTOS_TIMER_TASK_PRIORITY=1
CONFIG_FREERTOS_TIMER_TASK_STACK_DEPTH=1536
CONFIG_FREERTOS_TIMER_QUEUE_LENGTH=10
CONFIG_FREERTOS_QUEUE_REGISTRY_SIZE=0
CONFIG_FREERTOS_USE_TRACE_FACILITY=y
CONFIG_FREERTOS_USE_STATS_FORMATTING_FUNCTIONS=y
CONFIG_FREERTOS_VTASKLIST_INCLUDE_COREID=n
CONFIG_FREERTOS_GENERATE_RUN_TIME_STATS=y
CONFIG_FREERTOS_RUN_TIME_STATS_USING_ESP_TIMER=y
CONFIG_FREERTOS_RUN_TIME_STATS_USING_CPU_CLK=n
CONFIG_FREERTOS_DEBUG_INTERNALS=n
CONFIG_FREERTOS_TASK_FUNCTION_WRAPPER=y

#
# Heap memory debugging
#
CONFIG_HEAP_POISONING_DISABLED=n
CONFIG_HEAP_POISONING_LIGHT=y
CONFIG_HEAP_POISONING_COMPREHENSIVE=n
CONFIG_HEAP_TRACING=y
CONFIG_HEAP_TRACING_STACK_DEPTH=10

#
# Jolt Custom Cryptography Library
#

#
# Jolt types Library
#

#
# JoltOS
#
# ALWAYS USE KCONFIG DEFAULTS

#
# libsodium
#
CONFIG_LIBSODIUM_USE_MBEDTLS_SHA=y

#
# Log output
#
CONFIG_LOG_DEFAULT_LEVEL_NONE=n
CONFIG_LOG_DEFAULT_LEVEL_ERROR=y
CONFIG_LOG_DEFAULT_LEVEL_WARN=n
CONFIG_LOG_DEFAULT_LEVEL_INFO=n
CONFIG_LOG_DEFAULT_LEVEL_DEBUG=n
CONFIG_LOG_DEFAULT_LEVEL_VERBOSE=n
CONFIG_LOG_COLORS=y

#
# LWIP
#
CONFIG_LWIP_L2_TO_L3_COPY=n
CONFIG_LWIP_IRAM_OPTIMIZATION=n
CONFIG_LWIP_MAX_SOCKETS=10
CONFIG_LWIP_USE_ONLY_LWIP_SELECT=n
CONFIG_LWIP_SO_REUSE=y
CONFIG_LWIP_SO_REUSE_RXTOALL=y
CONFIG_LWIP_SO_RCVBUF=n
CONFIG_LWIP_DHCP_MAX_NTP_SERVERS=1
CONFIG_LWIP_IP_FRAG=n
CONFIG_LWIP_IP_REASSEMBLY=n
CONFIG_LWIP_STATS=n
CONFIG_LWIP_ETHARP_TRUST_IP_MAC=y
CONFIG_LWIP_ESP_GRATUITOUS_ARP=y
CONFIG_LWIP_GARP_TMR_INTERVAL=60
CONFIG_LWIP_TCPIP_RECVMBOX_SIZE=32
CONFIG_LWIP_DHCP_DOES_ARP_CHECK=y
CONFIG_LWIP_DHCP_RESTORE_LAST_IP=n

#
# DHCP server
#
CONFIG_LWIP_DHCPS_LEASE_UNIT=60
CONFIG_LWIP_DHCPS_MAX_STATION_NUM=8
CONFIG_LWIP_AUTOIP=n
CONFIG_LWIP_NETIF_LOOPBACK=y
CONFIG_LWIP_LOOPBACK_MAX_PBUFS=8

#
# TCP
#
CONFIG_LWIP_MAX_ACTIVE_TCP=16
CONFIG_LWIP_MAX_LISTENING_TCP=16
CONFIG_LWIP_TCP_MAXRTX=12
CONFIG_LWIP_TCP_SYNMAXRTX=6
CONFIG_LWIP_TCP_MSS=1436
CONFIG_LWIP_TCP_MSL=60000
CONFIG_LWIP_TCP_SND_BUF_DEFAULT=5744
CONFIG_LWIP_TCP_WND_DEFAULT=5744
CONFIG_LWIP_TCP_RECVMBOX_SIZE=6
CONFIG_LWIP_TCP_QUEUE_OOSEQ=y
CONFIG_LWIP_TCP_KEEP_CONNECTION_WHEN_IP_CHANGES=n
CONFIG_LWIP_TCP_OVERSIZE_MSS=y
CONFIG_LWIP_TCP_OVERSIZE_QUARTER_MSS=n
CONFIG_LWIP_TCP_OVERSIZE_DISABLE=n

#
# UDP
#
CONFIG_LWIP_MAX_UDP_PCBS=16
CONFIG_LWIP_UDP_RECVMBOX_SIZE=6
CONFIG_LWIP_TCPIP_TASK_STACK_SIZE=2560
CONFIG_LWIP_TCPIP_TASK_AFFINITY_NO_AFFINITY=y
CONFIG_LWIP_TCPIP_TASK_AFFINITY_CPU0=n
CONFIG_LWIP_TCPIP_TASK_AFFINITY_CPU1=n
CONFIG_LWIP_TCPIP_TASK_AFFINITY=0x7FFFFFFF
CONFIG_LWIP_PPP_SUPPORT=n

#
# ICMP
#
CONFIG_LWIP_MULTICAST_PING=n
CONFIG_LWIP_BROADCAST_PING=n

#
# LWIP RAW API
#
CONFIG_LWIP_MAX_RAW_PCBS=16

#
# mbedTLS
#
CONFIG_MBEDTLS_INTERNAL_MEM_ALLOC=y
CONFIG_MBEDTLS_DEFAULT_MEM_ALLOC=n
CONFIG_MBEDTLS_CUSTOM_MEM_ALLOC=n
CONFIG_MBEDTLS_SSL_MAX_CONTENT_LEN=3072
CONFIG_MBEDTLS_ASYMMETRIC_CONTENT_LEN=n
CONFIG_MBEDTLS_DEBUG=n
CONFIG_MBEDTLS_HARDWARE_AES=y
CONFIG_MBEDTLS_HARDWARE_MPI=n
CONFIG_MBEDTLS_HARDWARE_SHA=n
CONFIG_MBEDTLS_HAVE_TIME=y
CONFIG_MBEDTLS_HAVE_TIME_DATE=n
CONFIG_MBEDTLS_TLS_SERVER_AND_CLIENT=y
CONFIG_MBEDTLS_TLS_SERVER_ONLY=n
CONFIG_MBEDTLS_TLS_CLIENT_ONLY=n
CONFIG_MBEDTLS_TLS_DISABLED=n
CONFIG_MBEDTLS_TLS_SERVER=y
CONFIG_MBEDTLS_TLS_CLIENT=y
CONFIG_MBEDTLS_TLS_ENABLED=y
CONFIG_MBEDTLS_SSL_PROTO_TLS1=n
CONFIG_MBEDTLS_SSL_PROTO_TLS1_1=n

#
# TLS Key Exchange Methods
#
CONFIG_MBEDTLS_PSK_MODES=n
CONFIG_MBEDTLS_KEY_EXCHANGE_RSA=y
CONFIG_MBEDTLS_KEY_EXCHANGE_DHE_RSA=y
CONFIG_MBEDTLS_KEY_EXCHANGE_ELLIPTIC_CURVE=y
CONFIG_MBEDTLS_KEY_EXCHANGE_ECDHE_RSA=y
CONFIG_MBEDTLS_KEY_EXCHANGE_ECDHE_ECDSA=y
CONFIG_MBEDTLS_KEY_EXCHANGE_ECDH_ECDSA=y
CONFIG_MBEDTLS_KEY_EXCHANGE_ECDH_RSA=y
CONFIG_MBEDTLS_SSL_RENEGOTIATION=y
CONFIG_MBEDTLS_SSL_PROTO_SSL3=y
CONFIG_MBEDTLS_SSL_PROTO_DTLS=n
CONFIG_MBEDTLS_SSL_ALPN=y
CONFIG_MBEDTLS_SSL_SESSION_TICKETS=y

#
# Symmetric Ciphers
#
CONFIG_MBEDTLS_AES_C=y
CONFIG_MBEDTLS_CAMELLIA_C=n
CONFIG_MBEDTLS_DES_C=n
CONFIG_MBEDTLS_RC4_DISABLED=y
CONFIG_MBEDTLS_RC4_ENABLED_NO_DEFAULT=n
CONFIG_MBEDTLS_RC4_ENABLED=n
CONFIG_MBEDTLS_BLOWFISH_C=n
CONFIG_MBEDTLS_XTEA_C=n
CONFIG_MBEDTLS_CCM_C=y
CONFIG_MBEDTLS_GCM_C=y
CONFIG_MBEDTLS_RIPEMD160_C=y

#
# Certificates
#
CONFIG_MBEDTLS_PEM_PARSE_C=y
CONFIG_MBEDTLS_PEM_WRITE_C=y
CONFIG_MBEDTLS_X509_CRL_PARSE_C=y
CONFIG_MBEDTLS_X509_CSR_PARSE_C=y
CONFIG_MBEDTLS_ECP_C=y
CONFIG_MBEDTLS_ECDH_C=y
CONFIG_MBEDTLS_ECDSA_C=y
CONFIG_MBEDTLS_ECP_DP_SECP192R1_ENABLED=y
CONFIG_MBEDTLS_ECP_DP_SECP224R1_ENABLED=y
CONFIG_MBEDTLS_ECP_DP_SECP256R1_ENABLED=y
CONFIG_MBEDTLS_ECP_DP_SECP384R1_ENABLED=y
CONFIG_MBEDTLS_ECP_DP_SECP521R1_ENABLED=y
CONFIG_MBEDTLS_ECP_DP_SECP192K1_ENABLED=y
CONFIG_MBEDTLS_ECP_DP_SECP224K1_ENABLED=y
CONFIG_MBEDTLS_ECP_DP_SECP256K1_ENABLED=y
CONFIG_MBEDTLS_ECP_DP_BP256R1_ENABLED=y
CONFIG_MBEDTLS_ECP_DP_BP384R1_ENABLED=y
CONFIG_MBEDTLS_ECP_DP_BP512R1_ENABLED=y
CONFIG_MBEDTLS_ECP_DP_CURVE25519_ENABLED=y
CONFIG_MBEDTLS_ECP_NIST_OPTIM=y

#
# mDNS
#
CONFIG_MDNS_MAX_SERVICES=10

#
# ESP-MQTT Configurations
#
CONFIG_MQTT_PROTOCOL_311=y
CONFIG_MQTT_TRANSPORT_SSL=y
CONFIG_MQTT_TRANSPORT_WEBSOCKET=y
CONFIG_MQTT_TRANSPORT_WEBSOCKET_SECURE=y
CONFIG_MQTT_USE_CUSTOM_CONFIG=n
CONFIG_MQTT_TASK_CORE_SELECTION_ENABLED=n
CONFIG_MQTT_CUSTOM_OUTBOX=n

#
# Simple REST Interface
#
CONFIG_NANO_REST_DOMAIN="yapraiwallet.space"
CONFIG_NANO_REST_PATH="/api"
CONFIG_NANO_REST_PORT=5523
CONFIG_NANO_REST_RECEIVE_TIMEOUT=15
CONFIG_NANO_REST_RECEIVE_BLOCK_SIZE=512

#
# NVS
#

#
# OpenSSL
#
CONFIG_OPENSSL_DEBUG=n
CONFIG_OPENSSL_ASSERT_DO_NOTHING=y
CONFIG_OPENSSL_ASSERT_EXIT=n

#
# PThreads
#
CONFIG_PTHREAD_TASK_PRIO_DEFAULT=5
CONFIG_PTHREAD_TASK_STACK_SIZE_DEFAULT=3072
CONFIG_PTHREAD_STACK_MIN=768
CONFIG_PTHREAD_DEFAULT_CORE_NO_AFFINITY=y
CONFIG_PTHREAD_DEFAULT_CORE_0=n
CONFIG_PTHREAD_DEFAULT_CORE_1=n
CONFIG_PTHREAD_TASK_CORE_DEFAULT=-1
CONFIG_PTHREAD_TASK_NAME_DEFAULT="pthread"

#
# SPI Flash driver
#
CONFIG_SPI_FLASH_VERIFY_WRITE=n
CONFIG_SPI_FLASH_ENABLE_COUNTERS=n
CONFIG_SPI_FLASH_ROM_DRIVER_PATCH=y
CONFIG_SPI_FLASH_DANGEROUS_WRITE_ABORTS=y
CONFIG_SPI_FLASH_DANGEROUS_WRITE_FAILS=n
CONFIG_SPI_FLASH_DANGEROUS_WRITE_ALLOWED=n

#
# SPIFFS Configuration
#
CONFIG_SPIFFS_MAX_PARTITIONS=3

#
# SPIFFS Cache Configuration
#
CONFIG_SPIFFS_CACHE=y
CONFIG_SPIFFS_CACHE_WR=y
CONFIG_SPIFFS_CACHE_STATS=n
CONFIG_SPIFFS_PAGE_CHECK=y
CONFIG_SPIFFS_GC_MAX_RUNS=10
CONFIG_SPIFFS_GC_STATS=n
CONFIG_SPIFFS_PAGE_SIZE=256
CONFIG_SPIFFS_OBJ_NAME_LEN=32
CONFIG_SPIFFS_USE_MAGIC=y
CONFIG_SPIFFS_USE_MAGIC_LENGTH=y
CONFIG_SPIFFS_META_LENGTH=4
CONFIG_SPIFFS_USE_MTIME=y

#
# LittleFS
#
CONFIG_LITTLEFS_MAX_PARTITIONS=1
CONFIG_LITTLEFS_PAGE_SIZE=256
CONFIG_LITTLEFS_OBJ_NAME_LEN=128
CONFIG_LITTLEFS_READ_SIZE=128
CONFIG_LITTLEFS_WRITE_SIZE=128
CONFIG_LITTLEFS_LOOKAHEAD_SIZE=128
CONFIG_LITTLEFS_CACHE_SIZE=128
CONFIG_LITTLEFS_BLOCK_CYCLES=512
CONFIG_LITTLEFS_USE_MTIME=y
CONFIG_LITTLEFS_MTIME_USE_NONCE=y


#
# Debug Configuration
#
CONFIG_SPIFFS_DBG=n
CONFIG_SPIFFS_API_DBG=n
CONFIG_SPIFFS_GC_DBG=n
CONFIG_SPIFFS_CACHE_DBG=n
CONFIG_SPIFFS_CHECK_DBG=n
CONFIG_SPIFFS_TEST_VISUALISATION=n

#
# TCP/IP Adapter
#
CONFIG_NETIF_IP_LOST_TIMER_INTERVAL=120
CONFIG_TCPIP_LWIP=y

#
# Unity unit testing library
#
CONFIG_UNITY_ENABLE_FLOAT=y
CONFIG_UNITY_ENABLE_DOUBLE=y
CONFIG_UNITY_ENABLE_COLOR=y
CONFIG_UNITY_ENABLE_IDF_TEST_RUNNER=y
CONFIG_UNITY_ENABLE_BACKTRACE_ON_FAIL=y
CONFIG_UNITY_ENABLE_FIXTURE=n
CONFIG_UNITY_FREERTOS_STACK_SIZE=12000

#
# Virtual file system
#
CONFIG_VFS_SUPPRESS_SELECT_DEBUG_OUTPUT=y
CONFIG_VFS_SUPPORT_TERMIOS=y

#
# Wear Levelling
#
CONFIG_WL_SECTOR_SIZE_512=y
CONFIG_WL_SECTOR_SIZE_4096=n
CONFIG_WL_SECTOR_SIZE=512
```
