## sdkconfig.defaults
```kconfig
#
# Application manager
#
CONFIG_APP_COMPILE_TIME_DATE=y

#
# Bootloader config
#
CONFIG_LOG_BOOTLOADER_LEVEL_NONE=y

#
# Security features
#

#
# Serial flasher config
#
CONFIG_ESPTOOLPY_BAUD_OTHER=y
CONFIG_ESPTOOLPY_BAUD_OTHER_VAL=1500000
CONFIG_ESPTOOLPY_COMPRESSED=y
CONFIG_FLASHMODE_QIO=y
CONFIG_ESPTOOLPY_FLASHFREQ_80M=y
CONFIG_ESPTOOLPY_FLASHFREQ="80m"
CONFIG_ESPTOOLPY_FLASHSIZE_4MB=y
CONFIG_ESPTOOLPY_FLASHSIZE="4MB"
CONFIG_ESPTOOLPY_BEFORE_RESET=y
CONFIG_ESPTOOLPY_BEFORE="default_reset"
CONFIG_ESPTOOLPY_AFTER_RESET=y
CONFIG_ESPTOOLPY_AFTER_NORESET=
CONFIG_ESPTOOLPY_AFTER="hard_reset"
CONFIG_MONITOR_BAUD_OTHER=y
CONFIG_MONITOR_BAUD_OTHER_VAL=1500000

#
# Partition Table
#
CONFIG_PARTITION_TABLE_CUSTOM=y
CONFIG_PARTITION_TABLE_CUSTOM_FILENAME="partitions.csv"
CONFIG_PARTITION_TABLE_FILENAME="partitions.csv"
CONFIG_PARTITION_TABLE_OFFSET=0x8000
CONFIG_PARTITION_TABLE_MD5=y

#
# Compiler options
#
CONFIG_OPTIMIZATION_LEVEL_RELEASE=y
CONFIG_OPTIMIZATION_ASSERTIONS_SILENT=y
CONFIG_STACK_CHECK_STRONG=y

#
# Component config
#

#
# Application Level Tracing
#

#
# BIP Mnemonic
#

#
# Bluetooth
#
CONFIG_BT_ENABLED=y

#
# Bluetooth controller
#
CONFIG_BTDM_CONTROLLER_MODE_BLE_ONLY=y
CONFIG_BTDM_CONTROLLER_MODE_BR_EDR_ONLY=
CONFIG_BTDM_CONTROLLER_MODE_BTDM=
CONFIG_BTDM_CONTROLLER_BLE_MAX_CONN=3
CONFIG_BTDM_CONTROLLER_BLE_MAX_CONN_EFF=3
CONFIG_BTDM_CONTROLLER_BR_EDR_MAX_ACL_CONN_EFF=0
CONFIG_BTDM_CONTROLLER_BR_EDR_MAX_SYNC_CONN_EFF=0
CONFIG_BTDM_CONTROLLER_PINNED_TO_CORE_0=y
CONFIG_BTDM_CONTROLLER_PINNED_TO_CORE_1=
CONFIG_BTDM_CONTROLLER_PINNED_TO_CORE=0
CONFIG_BTDM_CONTROLLER_HCI_MODE_VHCI=y
CONFIG_BTDM_CONTROLLER_HCI_MODE_UART_H4=

#
# MODEM SLEEP Options
#
CONFIG_BTDM_CONTROLLER_MODEM_SLEEP=y
CONFIG_BTDM_MODEM_SLEEP_MODE_ORIG=y
CONFIG_BTDM_MODEM_SLEEP_MODE_EVED=
CONFIG_BTDM_LPCLK_SEL_MAIN_XTAL=y
CONFIG_BLE_SCAN_DUPLICATE=y
CONFIG_SCAN_DUPLICATE_BY_DEVICE_ADDR=y
CONFIG_SCAN_DUPLICATE_BY_ADV_DATA=
CONFIG_SCAN_DUPLICATE_BY_ADV_DATA_AND_DEVICE_ADDR=
CONFIG_SCAN_DUPLICATE_TYPE=0
CONFIG_DUPLICATE_SCAN_CACHE_SIZE=200
CONFIG_BLE_MESH_SCAN_DUPLICATE_EN=
CONFIG_BTDM_CONTROLLER_FULL_SCAN_SUPPORTED=
CONFIG_BLUEDROID_ENABLED=y
CONFIG_BLUEDROID_PINNED_TO_CORE_0=y
CONFIG_BLUEDROID_PINNED_TO_CORE_1=
CONFIG_BLUEDROID_PINNED_TO_CORE=0
CONFIG_BTC_TASK_STACK_SIZE=3072
CONFIG_BTU_TASK_STACK_SIZE=4096
CONFIG_BLUEDROID_MEM_DEBUG=
CONFIG_CLASSIC_BT_ENABLED=
CONFIG_GATTS_ENABLE=y
CONFIG_GATTS_SEND_SERVICE_CHANGE_MANUAL=
CONFIG_GATTS_SEND_SERVICE_CHANGE_AUTO=y
CONFIG_GATTS_SEND_SERVICE_CHANGE_MODE=0
CONFIG_GATTC_ENABLE=y
CONFIG_GATTC_CACHE_NVS_FLASH=
CONFIG_BLE_SMP_ENABLE=y
CONFIG_BT_STACK_NO_LOG=

#
# BT DEBUG LOG LEVEL
#
CONFIG_HCI_TRACE_LEVEL_NONE=
CONFIG_HCI_TRACE_LEVEL_ERROR=
CONFIG_HCI_TRACE_LEVEL_WARNING=y
CONFIG_HCI_TRACE_LEVEL_API=
CONFIG_HCI_TRACE_LEVEL_EVENT=
CONFIG_HCI_TRACE_LEVEL_DEBUG=
CONFIG_HCI_TRACE_LEVEL_VERBOSE=
CONFIG_HCI_INITIAL_TRACE_LEVEL=2
CONFIG_BTM_TRACE_LEVEL_NONE=
CONFIG_BTM_TRACE_LEVEL_ERROR=
CONFIG_BTM_TRACE_LEVEL_WARNING=y
CONFIG_BTM_TRACE_LEVEL_API=
CONFIG_BTM_TRACE_LEVEL_EVENT=
CONFIG_BTM_TRACE_LEVEL_DEBUG=
CONFIG_BTM_TRACE_LEVEL_VERBOSE=
CONFIG_BTM_INITIAL_TRACE_LEVEL=2
CONFIG_L2CAP_TRACE_LEVEL_NONE=
CONFIG_L2CAP_TRACE_LEVEL_ERROR=
CONFIG_L2CAP_TRACE_LEVEL_WARNING=y
CONFIG_L2CAP_TRACE_LEVEL_API=
CONFIG_L2CAP_TRACE_LEVEL_EVENT=
CONFIG_L2CAP_TRACE_LEVEL_DEBUG=
CONFIG_L2CAP_TRACE_LEVEL_VERBOSE=
CONFIG_L2CAP_INITIAL_TRACE_LEVEL=2
CONFIG_RFCOMM_TRACE_LEVEL_NONE=
CONFIG_RFCOMM_TRACE_LEVEL_ERROR=
CONFIG_RFCOMM_TRACE_LEVEL_WARNING=y
CONFIG_RFCOMM_TRACE_LEVEL_API=
CONFIG_RFCOMM_TRACE_LEVEL_EVENT=
CONFIG_RFCOMM_TRACE_LEVEL_DEBUG=
CONFIG_RFCOMM_TRACE_LEVEL_VERBOSE=
CONFIG_RFCOMM_INITIAL_TRACE_LEVEL=2
CONFIG_SDP_TRACE_LEVEL_NONE=
CONFIG_SDP_TRACE_LEVEL_ERROR=
CONFIG_SDP_TRACE_LEVEL_WARNING=y
CONFIG_SDP_TRACE_LEVEL_API=
CONFIG_SDP_TRACE_LEVEL_EVENT=
CONFIG_SDP_TRACE_LEVEL_DEBUG=
CONFIG_SDP_TRACE_LEVEL_VERBOSE=
CONFIG_SDP_INITIAL_TRACE_LEVEL=2
CONFIG_GAP_TRACE_LEVEL_NONE=
CONFIG_GAP_TRACE_LEVEL_ERROR=
CONFIG_GAP_TRACE_LEVEL_WARNING=y
CONFIG_GAP_TRACE_LEVEL_API=
CONFIG_GAP_TRACE_LEVEL_EVENT=
CONFIG_GAP_TRACE_LEVEL_DEBUG=
CONFIG_GAP_TRACE_LEVEL_VERBOSE=
CONFIG_GAP_INITIAL_TRACE_LEVEL=2
CONFIG_BNEP_TRACE_LEVEL_NONE=
CONFIG_BNEP_TRACE_LEVEL_ERROR=
CONFIG_BNEP_TRACE_LEVEL_WARNING=y
CONFIG_BNEP_TRACE_LEVEL_API=
CONFIG_BNEP_TRACE_LEVEL_EVENT=
CONFIG_BNEP_TRACE_LEVEL_DEBUG=
CONFIG_BNEP_TRACE_LEVEL_VERBOSE=
CONFIG_BNEP_INITIAL_TRACE_LEVEL=2
CONFIG_PAN_TRACE_LEVEL_NONE=
CONFIG_PAN_TRACE_LEVEL_ERROR=
CONFIG_PAN_TRACE_LEVEL_WARNING=y
CONFIG_PAN_TRACE_LEVEL_API=
CONFIG_PAN_TRACE_LEVEL_EVENT=
CONFIG_PAN_TRACE_LEVEL_DEBUG=
CONFIG_PAN_TRACE_LEVEL_VERBOSE=
CONFIG_PAN_INITIAL_TRACE_LEVEL=2
CONFIG_A2D_TRACE_LEVEL_NONE=
CONFIG_A2D_TRACE_LEVEL_ERROR=
CONFIG_A2D_TRACE_LEVEL_WARNING=y
CONFIG_A2D_TRACE_LEVEL_API=
CONFIG_A2D_TRACE_LEVEL_EVENT=
CONFIG_A2D_TRACE_LEVEL_DEBUG=
CONFIG_A2D_TRACE_LEVEL_VERBOSE=
CONFIG_A2D_INITIAL_TRACE_LEVEL=2
CONFIG_AVDT_TRACE_LEVEL_NONE=
CONFIG_AVDT_TRACE_LEVEL_ERROR=
CONFIG_AVDT_TRACE_LEVEL_WARNING=y
CONFIG_AVDT_TRACE_LEVEL_API=
CONFIG_AVDT_TRACE_LEVEL_EVENT=
CONFIG_AVDT_TRACE_LEVEL_DEBUG=
CONFIG_AVDT_TRACE_LEVEL_VERBOSE=
CONFIG_AVDT_INITIAL_TRACE_LEVEL=2
CONFIG_AVCT_TRACE_LEVEL_NONE=
CONFIG_AVCT_TRACE_LEVEL_ERROR=
CONFIG_AVCT_TRACE_LEVEL_WARNING=y
CONFIG_AVCT_TRACE_LEVEL_API=
CONFIG_AVCT_TRACE_LEVEL_EVENT=
CONFIG_AVCT_TRACE_LEVEL_DEBUG=
CONFIG_AVCT_TRACE_LEVEL_VERBOSE=
CONFIG_AVCT_INITIAL_TRACE_LEVEL=2
CONFIG_AVRC_TRACE_LEVEL_NONE=
CONFIG_AVRC_TRACE_LEVEL_ERROR=
CONFIG_AVRC_TRACE_LEVEL_WARNING=y
CONFIG_AVRC_TRACE_LEVEL_API=
CONFIG_AVRC_TRACE_LEVEL_EVENT=
CONFIG_AVRC_TRACE_LEVEL_DEBUG=
CONFIG_AVRC_TRACE_LEVEL_VERBOSE=
CONFIG_AVRC_INITIAL_TRACE_LEVEL=2
CONFIG_MCA_TRACE_LEVEL_NONE=
CONFIG_MCA_TRACE_LEVEL_ERROR=
CONFIG_MCA_TRACE_LEVEL_WARNING=y
CONFIG_MCA_TRACE_LEVEL_API=
CONFIG_MCA_TRACE_LEVEL_EVENT=
CONFIG_MCA_TRACE_LEVEL_DEBUG=
CONFIG_MCA_TRACE_LEVEL_VERBOSE=
CONFIG_MCA_INITIAL_TRACE_LEVEL=2
CONFIG_HID_TRACE_LEVEL_NONE=
CONFIG_HID_TRACE_LEVEL_ERROR=
CONFIG_HID_TRACE_LEVEL_WARNING=y
CONFIG_HID_TRACE_LEVEL_API=
CONFIG_HID_TRACE_LEVEL_EVENT=
CONFIG_HID_TRACE_LEVEL_DEBUG=
CONFIG_HID_TRACE_LEVEL_VERBOSE=
CONFIG_HID_INITIAL_TRACE_LEVEL=2
CONFIG_APPL_TRACE_LEVEL_NONE=
CONFIG_APPL_TRACE_LEVEL_ERROR=
CONFIG_APPL_TRACE_LEVEL_WARNING=y
CONFIG_APPL_TRACE_LEVEL_API=
CONFIG_APPL_TRACE_LEVEL_EVENT=
CONFIG_APPL_TRACE_LEVEL_DEBUG=
CONFIG_APPL_TRACE_LEVEL_VERBOSE=
CONFIG_APPL_INITIAL_TRACE_LEVEL=2
CONFIG_GATT_TRACE_LEVEL_NONE=
CONFIG_GATT_TRACE_LEVEL_ERROR=
CONFIG_GATT_TRACE_LEVEL_WARNING=y
CONFIG_GATT_TRACE_LEVEL_API=
CONFIG_GATT_TRACE_LEVEL_EVENT=
CONFIG_GATT_TRACE_LEVEL_DEBUG=
CONFIG_GATT_TRACE_LEVEL_VERBOSE=
CONFIG_GATT_INITIAL_TRACE_LEVEL=2
CONFIG_SMP_TRACE_LEVEL_NONE=
CONFIG_SMP_TRACE_LEVEL_ERROR=
CONFIG_SMP_TRACE_LEVEL_WARNING=y
CONFIG_SMP_TRACE_LEVEL_API=
CONFIG_SMP_TRACE_LEVEL_EVENT=
CONFIG_SMP_TRACE_LEVEL_DEBUG=
CONFIG_SMP_TRACE_LEVEL_VERBOSE=
CONFIG_SMP_INITIAL_TRACE_LEVEL=2
CONFIG_BTIF_TRACE_LEVEL_NONE=
CONFIG_BTIF_TRACE_LEVEL_ERROR=
CONFIG_BTIF_TRACE_LEVEL_WARNING=y
CONFIG_BTIF_TRACE_LEVEL_API=
CONFIG_BTIF_TRACE_LEVEL_EVENT=
CONFIG_BTIF_TRACE_LEVEL_DEBUG=
CONFIG_BTIF_TRACE_LEVEL_VERBOSE=
CONFIG_BTIF_INITIAL_TRACE_LEVEL=2
CONFIG_BTC_TRACE_LEVEL_NONE=
CONFIG_BTC_TRACE_LEVEL_ERROR=
CONFIG_BTC_TRACE_LEVEL_WARNING=y
CONFIG_BTC_TRACE_LEVEL_API=
CONFIG_BTC_TRACE_LEVEL_EVENT=
CONFIG_BTC_TRACE_LEVEL_DEBUG=
CONFIG_BTC_TRACE_LEVEL_VERBOSE=
CONFIG_BTC_INITIAL_TRACE_LEVEL=2
CONFIG_OSI_TRACE_LEVEL_NONE=
CONFIG_OSI_TRACE_LEVEL_ERROR=
CONFIG_OSI_TRACE_LEVEL_WARNING=y
CONFIG_OSI_TRACE_LEVEL_API=
CONFIG_OSI_TRACE_LEVEL_EVENT=
CONFIG_OSI_TRACE_LEVEL_DEBUG=
CONFIG_OSI_TRACE_LEVEL_VERBOSE=
CONFIG_OSI_INITIAL_TRACE_LEVEL=2
CONFIG_BLUFI_TRACE_LEVEL_NONE=
CONFIG_BLUFI_TRACE_LEVEL_ERROR=
CONFIG_BLUFI_TRACE_LEVEL_WARNING=y
CONFIG_BLUFI_TRACE_LEVEL_API=
CONFIG_BLUFI_TRACE_LEVEL_EVENT=
CONFIG_BLUFI_TRACE_LEVEL_DEBUG=
CONFIG_BLUFI_TRACE_LEVEL_VERBOSE=
CONFIG_BLUFI_INITIAL_TRACE_LEVEL=2
CONFIG_BT_ACL_CONNECTIONS=4
CONFIG_BT_ALLOCATION_FROM_SPIRAM_FIRST=
CONFIG_BT_BLE_DYNAMIC_ENV_MEMORY=
CONFIG_BLE_HOST_QUEUE_CONGESTION_CHECK=
CONFIG_SMP_ENABLE=y
CONFIG_BT_RESERVE_DRAM=0xdb5c

#
# Driver configurations
#

#
# ADC configuration
#
CONFIG_ADC_FORCE_XPD_FSM=y
CONFIG_ADC2_DISABLE_DAC=y

#
# SPI configuration
#
CONFIG_SPI_MASTER_IN_IRAM=y
CONFIG_SPI_MASTER_ISR_IN_IRAM=y
CONFIG_SPI_SLAVE_IN_IRAM=
CONFIG_SPI_SLAVE_ISR_IN_IRAM=y

#
# Easy_Input Config
#

#
# Push Buttons
#
CONFIG_EASY_INPUT_PUSH_BUTTON_ENABLE=

#
# Touch
#
CONFIG_EASY_INPUT_TOUCH_ENABLE=y
CONFIG_EASY_INPUT_TOUCH_UP_PIN=7
CONFIG_EASY_INPUT_TOUCH_DOWN_PIN=6
CONFIG_EASY_INPUT_TOUCH_LEFT_PIN=-1
CONFIG_EASY_INPUT_TOUCH_RIGHT_PIN=-1
CONFIG_EASY_INPUT_TOUCH_BACK_PIN=5
CONFIG_EASY_INPUT_TOUCH_ENTER_PIN=8
CONFIG_EASY_INPUT_TOUCH_FILTER_PERIOD_MS=10
CONFIG_EASY_INPUT_TOUCH_THRESH_PERCENT=750
CONFIG_EASY_INPUT_TOUCH_PERIOD=33
CONFIG_EASY_INPUT_HOLD_ENABLE=y
CONFIG_EASY_INPUT_HOLD_SLOW_DELAY=12
CONFIG_EASY_INPUT_HOLD_FAST_DELAY=24
CONFIG_EASY_INPUT_HOLD_SLOW_PERIOD=6
CONFIG_EASY_INPUT_HOLD_FAST_PERIOD=3

#
# ESP32-specific
#
CONFIG_IDF_TARGET_ESP32=y
CONFIG_ESP32_DEFAULT_CPU_FREQ_240=y
CONFIG_ESP32_DEFAULT_CPU_FREQ_MHZ=240

#
# Core dump
#
CONFIG_ESP32_ENABLE_COREDUMP_TO_FLASH=
CONFIG_ESP32_ENABLE_COREDUMP_TO_UART=
CONFIG_ESP32_ENABLE_COREDUMP_TO_NONE=y
CONFIG_ESP32_ENABLE_COREDUMP=
CONFIG_TWO_UNIVERSAL_MAC_ADDRESS=
CONFIG_FOUR_UNIVERSAL_MAC_ADDRESS=y
CONFIG_NUMBER_OF_UNIVERSAL_MAC_ADDRESS=4
CONFIG_SYSTEM_EVENT_QUEUE_SIZE=32
CONFIG_SYSTEM_EVENT_TASK_STACK_SIZE=2304
CONFIG_MAIN_TASK_STACK_SIZE=4096
CONFIG_IPC_TASK_STACK_SIZE=1024
CONFIG_TIMER_TASK_STACK_SIZE=3584
CONFIG_NEWLIB_STDOUT_LINE_ENDING_CRLF=y
CONFIG_NEWLIB_STDOUT_LINE_ENDING_LF=
CONFIG_NEWLIB_STDOUT_LINE_ENDING_CR=
CONFIG_NEWLIB_STDIN_LINE_ENDING_CRLF=
CONFIG_NEWLIB_STDIN_LINE_ENDING_LF=
CONFIG_NEWLIB_STDIN_LINE_ENDING_CR=y
CONFIG_NEWLIB_NANO_FORMAT=y
CONFIG_CONSOLE_UART_DEFAULT=y
CONFIG_CONSOLE_UART_CUSTOM=
CONFIG_CONSOLE_UART_NONE=
CONFIG_CONSOLE_UART_NUM=0
CONFIG_CONSOLE_UART_BAUDRATE=1500000
CONFIG_ULP_COPROC_ENABLED=
CONFIG_ULP_COPROC_RESERVE_MEM=0
CONFIG_ESP32_PANIC_PRINT_HALT=
CONFIG_ESP32_PANIC_PRINT_REBOOT=
CONFIG_ESP32_PANIC_SILENT_REBOOT=
CONFIG_ESP32_PANIC_GDBSTUB=y
CONFIG_ESP32_DEBUG_OCDAWARE=y
CONFIG_ESP32_DEBUG_STUBS_ENABLE=y
CONFIG_INT_WDT=y
CONFIG_INT_WDT_TIMEOUT_MS=300
CONFIG_INT_WDT_CHECK_CPU1=y
CONFIG_TASK_WDT=y
CONFIG_TASK_WDT_PANIC=
CONFIG_TASK_WDT_TIMEOUT_S=15
CONFIG_TASK_WDT_CHECK_IDLE_TASK_CPU0=y
CONFIG_TASK_WDT_CHECK_IDLE_TASK_CPU1=y
CONFIG_BROWNOUT_DET=y
CONFIG_BROWNOUT_DET_LVL_SEL_0=y
CONFIG_BROWNOUT_DET_LVL_SEL_1=
CONFIG_BROWNOUT_DET_LVL_SEL_2=
CONFIG_BROWNOUT_DET_LVL_SEL_3=
CONFIG_BROWNOUT_DET_LVL_SEL_4=
CONFIG_BROWNOUT_DET_LVL_SEL_5=
CONFIG_BROWNOUT_DET_LVL_SEL_6=
CONFIG_BROWNOUT_DET_LVL_SEL_7=
CONFIG_BROWNOUT_DET_LVL=0
CONFIG_REDUCE_PHY_TX_POWER=y
CONFIG_ESP32_TIME_SYSCALL_USE_RTC_FRC1=y
CONFIG_ESP32_TIME_SYSCALL_USE_RTC=
CONFIG_ESP32_TIME_SYSCALL_USE_FRC1=
CONFIG_ESP32_TIME_SYSCALL_USE_NONE=
CONFIG_ESP32_RTC_CLOCK_SOURCE_INTERNAL_RC=y
CONFIG_ESP32_RTC_CLOCK_SOURCE_EXTERNAL_CRYSTAL=
CONFIG_ESP32_RTC_CLOCK_SOURCE_EXTERNAL_OSC=
CONFIG_ESP32_RTC_CLOCK_SOURCE_INTERNAL_8MD256=
CONFIG_ESP32_RTC_CLK_CAL_CYCLES=1024
CONFIG_ESP32_DEEP_SLEEP_WAKEUP_DELAY=2000
CONFIG_ESP32_XTAL_FREQ_40=
CONFIG_ESP32_XTAL_FREQ_26=
CONFIG_ESP32_XTAL_FREQ_AUTO=y
CONFIG_ESP32_XTAL_FREQ=0
CONFIG_DISABLE_BASIC_ROM_CONSOLE=
CONFIG_ESP_TIMER_PROFILING=
CONFIG_COMPATIBLE_PRE_V2_1_BOOTLOADERS=
CONFIG_ESP_ERR_TO_NAME_LOOKUP=y

#
# Wi-Fi
#
CONFIG_SW_COEXIST_ENABLE=y
CONFIG_SW_COEXIST_PREFERENCE_WIFI=
CONFIG_SW_COEXIST_PREFERENCE_BT=
CONFIG_SW_COEXIST_PREFERENCE_BALANCE=y
CONFIG_SW_COEXIST_PREFERENCE_VALUE=2
CONFIG_ESP32_WIFI_STATIC_RX_BUFFER_NUM=2
CONFIG_ESP32_WIFI_DYNAMIC_RX_BUFFER_NUM=16
CONFIG_ESP32_WIFI_STATIC_TX_BUFFER=
CONFIG_ESP32_WIFI_DYNAMIC_TX_BUFFER=y
CONFIG_ESP32_WIFI_TX_BUFFER_TYPE=1
CONFIG_ESP32_WIFI_DYNAMIC_TX_BUFFER_NUM=16
CONFIG_ESP32_WIFI_CSI_ENABLED=
CONFIG_ESP32_WIFI_AMPDU_TX_ENABLED=y
CONFIG_ESP32_WIFI_TX_BA_WIN=6
CONFIG_ESP32_WIFI_AMPDU_RX_ENABLED=y
CONFIG_ESP32_WIFI_RX_BA_WIN=6
CONFIG_ESP32_WIFI_NVS_ENABLED=y
CONFIG_ESP32_WIFI_TASK_PINNED_TO_CORE_0=y
CONFIG_ESP32_WIFI_TASK_PINNED_TO_CORE_1=
CONFIG_ESP32_WIFI_SOFTAP_BEACON_MAX_LEN=752
CONFIG_ESP32_WIFI_DEBUG_LOG_ENABLE=

#
# PHY
#
CONFIG_ESP32_PHY_CALIBRATION_AND_DATA_STORAGE=y
CONFIG_ESP32_PHY_INIT_DATA_IN_PARTITION=
CONFIG_ESP32_PHY_MAX_WIFI_TX_POWER=20
CONFIG_ESP32_PHY_MAX_TX_POWER=20

#
# Power Management
#
CONFIG_PM_ENABLE=

#
# ADC-Calibration
#
CONFIG_ADC_CAL_EFUSE_TP_ENABLE=y
CONFIG_ADC_CAL_EFUSE_VREF_ENABLE=y
CONFIG_ADC_CAL_LUT_ENABLE=y

#
# Event Loop Library
#
CONFIG_EVENT_LOOP_PROFILING=

#
# ESP HTTP client
#
CONFIG_ESP_HTTP_CLIENT_ENABLE_HTTPS=y

#
# HTTP Server
#
CONFIG_HTTPD_MAX_REQ_HDR_LEN=512
CONFIG_HTTPD_MAX_URI_LEN=512

#
# Ethernet
#
CONFIG_DMA_RX_BUF_NUM=10
CONFIG_DMA_TX_BUF_NUM=10
CONFIG_EMAC_L2_TO_L3_RX_BUF_MODE=
CONFIG_EMAC_CHECK_LINK_PERIOD_MS=2000
CONFIG_EMAC_TASK_PRIORITY=20
CONFIG_EMAC_TASK_STACK_SIZE=3072

#
# FAT Filesystem support
#
CONFIG_FATFS_CODEPAGE_DYNAMIC=
CONFIG_FATFS_CODEPAGE_437=y
CONFIG_FATFS_CODEPAGE_720=
CONFIG_FATFS_CODEPAGE_737=
CONFIG_FATFS_CODEPAGE_771=
CONFIG_FATFS_CODEPAGE_775=
CONFIG_FATFS_CODEPAGE_850=
CONFIG_FATFS_CODEPAGE_852=
CONFIG_FATFS_CODEPAGE_855=
CONFIG_FATFS_CODEPAGE_857=
CONFIG_FATFS_CODEPAGE_860=
CONFIG_FATFS_CODEPAGE_861=
CONFIG_FATFS_CODEPAGE_862=
CONFIG_FATFS_CODEPAGE_863=
CONFIG_FATFS_CODEPAGE_864=
CONFIG_FATFS_CODEPAGE_865=
CONFIG_FATFS_CODEPAGE_866=
CONFIG_FATFS_CODEPAGE_869=
CONFIG_FATFS_CODEPAGE_932=
CONFIG_FATFS_CODEPAGE_936=
CONFIG_FATFS_CODEPAGE_949=
CONFIG_FATFS_CODEPAGE_950=
CONFIG_FATFS_CODEPAGE=437
CONFIG_FATFS_LFN_NONE=y
CONFIG_FATFS_LFN_HEAP=
CONFIG_FATFS_LFN_STACK=
CONFIG_FATFS_FS_LOCK=0
CONFIG_FATFS_TIMEOUT_MS=10000
CONFIG_FATFS_PER_FILE_CACHE=y

#
# Modbus configuration
#
CONFIG_MB_QUEUE_LENGTH=20
CONFIG_MB_SERIAL_TASK_STACK_SIZE=2048
CONFIG_MB_SERIAL_BUF_SIZE=256
CONFIG_MB_SERIAL_TASK_PRIO=10
CONFIG_MB_CONTROLLER_SLAVE_ID_SUPPORT=
CONFIG_MB_CONTROLLER_NOTIFY_TIMEOUT=20
CONFIG_MB_CONTROLLER_NOTIFY_QUEUE_SIZE=20
CONFIG_MB_CONTROLLER_STACK_SIZE=4096
CONFIG_MB_EVENT_QUEUE_TIMEOUT=20
CONFIG_MB_TIMER_PORT_ENABLED=y
CONFIG_MB_TIMER_GROUP=0
CONFIG_MB_TIMER_INDEX=0

#
# FreeRTOS
#
CONFIG_FREERTOS_UNICORE=
CONFIG_FREERTOS_NO_AFFINITY=0x7FFFFFFF
CONFIG_FREERTOS_CORETIMER_0=y
CONFIG_FREERTOS_CORETIMER_1=
CONFIG_FREERTOS_HZ=200
CONFIG_FREERTOS_ASSERT_ON_UNTESTED_FUNCTION=y
CONFIG_FREERTOS_CHECK_STACKOVERFLOW_NONE=
CONFIG_FREERTOS_CHECK_STACKOVERFLOW_PTRVAL=
CONFIG_FREERTOS_CHECK_STACKOVERFLOW_CANARY=y
CONFIG_FREERTOS_WATCHPOINT_END_OF_STACK=
CONFIG_FREERTOS_INTERRUPT_BACKTRACE=y
CONFIG_FREERTOS_THREAD_LOCAL_STORAGE_POINTERS=1
CONFIG_FREERTOS_ASSERT_FAIL_ABORT=y
CONFIG_FREERTOS_ASSERT_FAIL_PRINT_CONTINUE=
CONFIG_FREERTOS_ASSERT_DISABLE=
CONFIG_FREERTOS_IDLE_TASK_STACKSIZE=1024
CONFIG_FREERTOS_ISR_STACKSIZE=1536
CONFIG_FREERTOS_LEGACY_HOOKS=
CONFIG_FREERTOS_MAX_TASK_NAME_LEN=16
CONFIG_SUPPORT_STATIC_ALLOCATION=
CONFIG_TIMER_TASK_PRIORITY=1
CONFIG_TIMER_TASK_STACK_DEPTH=2048
CONFIG_TIMER_QUEUE_LENGTH=10
CONFIG_FREERTOS_QUEUE_REGISTRY_SIZE=0
CONFIG_FREERTOS_USE_TRACE_FACILITY=y
CONFIG_FREERTOS_USE_STATS_FORMATTING_FUNCTIONS=y
CONFIG_FREERTOS_VTASKLIST_INCLUDE_COREID=
CONFIG_FREERTOS_GENERATE_RUN_TIME_STATS=y
CONFIG_FREERTOS_RUN_TIME_STATS_USING_ESP_TIMER=y
CONFIG_FREERTOS_RUN_TIME_STATS_USING_CPU_CLK=
CONFIG_FREERTOS_DEBUG_INTERNALS=
CONFIG_FREERTOS_TASK_FUNCTION_WRAPPER=y

#
# Heap memory debugging
#
CONFIG_HEAP_POISONING_DISABLED=
CONFIG_HEAP_POISONING_LIGHT=
CONFIG_HEAP_POISONING_COMPREHENSIVE=y
CONFIG_HEAP_TRACING=y
CONFIG_HEAP_TRACING_STACK_DEPTH=10

#
# Jolt Custom Cryptography Library
#

#
# Jolt types Library
#

#
# JoltOS
#

#
# I2C
#
CONFIG_JOLT_I2C_MASTER_NUM=1
CONFIG_JOLT_I2C_PIN_SDA=23
CONFIG_JOLT_I2C_PIN_SCL=22
CONFIG_JOLT_I2C_MASTER_FREQ_HZ=1200000
CONFIG_JOLT_I2C_TIMEOUT_MS=1000

#
# Jolt Cast
#
CONFIG_JOLT_CAST_DOMAIN="yapraiwallet.space"
CONFIG_JOLT_CAST_PORT=5523
CONFIG_JOLT_CAST_PATH="/api"

#
# Display
#
CONFIG_JOLT_DISPLAY_BRIGHTNESS=200
CONFIG_JOLT_DISPLAY_FLIP=y
CONFIG_JOLT_DISPLAY_ADDRESS=0x3C
CONFIG_JOLT_DISPLAY_PIN_RST=16
CONFIG_JOLT_HW_MONITOR_UPDATE_PERIOD_MS=250
CONFIG_JOLT_I2C_ERROR_RESET=

#
# GUI
#
CONFIG_JOLT_GUI_LOADING_BAR_ANIM_MS=100
CONFIG_JOLT_GUI_STATUSBAR_UPDATE_PERIOD_MS=250

#
# App Compression
#
CONFIG_JOLT_COMPRESSION_ENABLE=y
CONFIG_JOLT_COMPRESSION_OUTPUT_BUFFER=4096
CONFIG_JOLT_COMPRESSION_AUTO=y

#
# Vault
#
CONFIG_JOLT_VAULT_DEFAULT_TIMEOUT_S=300
CONFIG_JOLT_VAULT_TIMEOUT_TIMEOUT_MS=1000
CONFIG_JOLT_STORE_INTERNAL=y
CONFIG_JOLT_STORE_ATAES132A=

#
# Console
#
CONFIG_JOLT_CONSOLE_STARTUP_CLEAR=y
CONFIG_JOLT_CONSOLE_UART_RX_BUF_LEN=4096
CONFIG_JOLT_CONSOLE_UART_TX_BUF_LEN=0
CONFIG_JOLT_CONSOLE_MAX_ARGS=8
CONFIG_JOLT_CONSOLE_MAX_CMD_LEN=4096
CONFIG_JOLT_CONSOLE_HISTORY=20
CONFIG_JOLT_CONSOLE_OVERRIDE_LOGGING=
CONFIG_JOLT_DEFAULT_BOOT_SPLASH_ENABLE=y

#
# Task Stack Size
#
CONFIG_JOLT_TASK_STACK_SIZE_LVGL=8192
CONFIG_JOLT_TASK_STACK_SIZE_HW_MONITORS=2048
CONFIG_JOLT_TASK_STACK_SIZE_DERIVATION=4096
CONFIG_JOLT_TASK_STACK_SIZE_VAULT_WATCHDOG=4096
CONFIG_JOLT_TASK_STACK_SIZE_CONSOLE=4096
CONFIG_JOLT_TASK_CMD_STACK_SIZE_CONSOLE=8192
CONFIG_JOLT_TASK_STACK_SIZE_FACTORY_RESET=4096
CONFIG_JOLT_TASK_STACK_SIZE_APP_LAUNCHER=6200

#
# Task Priority
#
CONFIG_JOLT_TASK_PRIORITY_LVGL=17
CONFIG_JOLT_TASK_PRIORITY_HW_MONITORS=2
CONFIG_JOLT_TASK_PRIORITY_CONSOLE=15
CONFIG_JOLT_TASK_PRIORITY_CMD_CONSOLE=16
CONFIG_JOLT_TASK_PRIORITY_LAUNCHER=2
CONFIG_JOLT_TASK_PRIORITY_DERIVATION=2
CONFIG_JOLT_TASK_PRIORITY_VAULT_WATCHDOG=20
CONFIG_JOLT_TASK_PRIORITY_FACTORY_RESET=2
CONFIG_JOLT_TASK_PRIORITY_APP_LAUNCHER=2
CONFIG_JOLT_VAULT_RPC_QUEUE_LEN=8

#
# WiFi
#

#
# Battery
#
CONFIG_JOLT_VBATT_SENSE_PIN=32
CONFIG_JOLT_VBATT_MIN=2000
CONFIG_JOLT_VBATT_MAX=2470
CONFIG_JOLT_VBATT_AVG_WINDOW=10

#
# JELF Loader
#
CONFIG_JELFLOADER_PROFILER_EN=
CONFIG_JELFLOADER_CACHE_SHT=
CONFIG_JELFLOADER_CACHE_LOCALITY=y
CONFIG_JELFLOADER_CACHE_LOCALITY_CHUNK_SIZE=2048
CONFIG_JELFLOADER_CACHE_LOCALITY_CHUNK_N=6

#
# PIN Entry
#
CONFIG_JOLT_PIN_TITLE_PIN=
CONFIG_JOLT_PIN_TITLE_NAME=
CONFIG_JOLT_PIN_TITLE_PATH=y
CONFIG_JOLT_PIN_DEFAULT_MAX_ATTEMPT=10
CONFIG_JOLT_APP_KEY_DEFAULT="03a107bff3ce10be1d70dd18e74bc09967e4d6309ba50d5f1ddc8664125531b8"

#
# libsodium
#
CONFIG_LIBSODIUM_USE_MBEDTLS_SHA=y

#
# Log output
#
CONFIG_LOG_DEFAULT_LEVEL_NONE=
CONFIG_LOG_DEFAULT_LEVEL_ERROR=y
CONFIG_LOG_DEFAULT_LEVEL_WARN=
CONFIG_LOG_DEFAULT_LEVEL_INFO=
CONFIG_LOG_DEFAULT_LEVEL_DEBUG=
CONFIG_LOG_DEFAULT_LEVEL_VERBOSE=
CONFIG_LOG_COLORS=y

#
# LWIP
#
CONFIG_L2_TO_L3_COPY=
CONFIG_LWIP_IRAM_OPTIMIZATION=
CONFIG_LWIP_MAX_SOCKETS=10
CONFIG_USE_ONLY_LWIP_SELECT=
CONFIG_LWIP_SO_REUSE=y
CONFIG_LWIP_SO_REUSE_RXTOALL=y
CONFIG_LWIP_SO_RCVBUF=
CONFIG_LWIP_DHCP_MAX_NTP_SERVERS=1
CONFIG_LWIP_IP_FRAG=
CONFIG_LWIP_IP_REASSEMBLY=
CONFIG_LWIP_STATS=
CONFIG_LWIP_ETHARP_TRUST_IP_MAC=y
CONFIG_ESP_GRATUITOUS_ARP=y
CONFIG_GARP_TMR_INTERVAL=60
CONFIG_TCPIP_RECVMBOX_SIZE=32
CONFIG_LWIP_DHCP_DOES_ARP_CHECK=y
CONFIG_LWIP_DHCP_RESTORE_LAST_IP=

#
# DHCP server
#
CONFIG_LWIP_DHCPS_LEASE_UNIT=60
CONFIG_LWIP_DHCPS_MAX_STATION_NUM=8
CONFIG_LWIP_AUTOIP=
CONFIG_LWIP_NETIF_LOOPBACK=y
CONFIG_LWIP_LOOPBACK_MAX_PBUFS=8

#
# TCP
#
CONFIG_LWIP_MAX_ACTIVE_TCP=16
CONFIG_LWIP_MAX_LISTENING_TCP=16
CONFIG_TCP_MAXRTX=12
CONFIG_TCP_SYNMAXRTX=6
CONFIG_TCP_MSS=1436
CONFIG_TCP_MSL=60000
CONFIG_TCP_SND_BUF_DEFAULT=5744
CONFIG_TCP_WND_DEFAULT=5744
CONFIG_TCP_RECVMBOX_SIZE=6
CONFIG_TCP_QUEUE_OOSEQ=y
CONFIG_ESP_TCP_KEEP_CONNECTION_WHEN_IP_CHANGES=
CONFIG_TCP_OVERSIZE_MSS=y
CONFIG_TCP_OVERSIZE_QUARTER_MSS=
CONFIG_TCP_OVERSIZE_DISABLE=

#
# UDP
#
CONFIG_LWIP_MAX_UDP_PCBS=16
CONFIG_UDP_RECVMBOX_SIZE=6
CONFIG_TCPIP_TASK_STACK_SIZE=2560
CONFIG_TCPIP_TASK_AFFINITY_NO_AFFINITY=y
CONFIG_TCPIP_TASK_AFFINITY_CPU0=
CONFIG_TCPIP_TASK_AFFINITY_CPU1=
CONFIG_TCPIP_TASK_AFFINITY=0x7FFFFFFF
CONFIG_PPP_SUPPORT=

#
# ICMP
#
CONFIG_LWIP_MULTICAST_PING=
CONFIG_LWIP_BROADCAST_PING=

#
# LWIP RAW API
#
CONFIG_LWIP_MAX_RAW_PCBS=16

#
# mbedTLS
#
CONFIG_MBEDTLS_INTERNAL_MEM_ALLOC=y
CONFIG_MBEDTLS_DEFAULT_MEM_ALLOC=
CONFIG_MBEDTLS_CUSTOM_MEM_ALLOC=
CONFIG_MBEDTLS_SSL_MAX_CONTENT_LEN=3072
CONFIG_MBEDTLS_ASYMMETRIC_CONTENT_LEN=
CONFIG_MBEDTLS_DEBUG=
CONFIG_MBEDTLS_HARDWARE_AES=y
CONFIG_MBEDTLS_HARDWARE_MPI=
CONFIG_MBEDTLS_HARDWARE_SHA=
CONFIG_MBEDTLS_HAVE_TIME=y
CONFIG_MBEDTLS_HAVE_TIME_DATE=
CONFIG_MBEDTLS_TLS_SERVER_AND_CLIENT=y
CONFIG_MBEDTLS_TLS_SERVER_ONLY=
CONFIG_MBEDTLS_TLS_CLIENT_ONLY=
CONFIG_MBEDTLS_TLS_DISABLED=
CONFIG_MBEDTLS_TLS_SERVER=y
CONFIG_MBEDTLS_TLS_CLIENT=y
CONFIG_MBEDTLS_TLS_ENABLED=y

#
# TLS Key Exchange Methods
#
CONFIG_MBEDTLS_PSK_MODES=
CONFIG_MBEDTLS_KEY_EXCHANGE_RSA=y
CONFIG_MBEDTLS_KEY_EXCHANGE_DHE_RSA=y
CONFIG_MBEDTLS_KEY_EXCHANGE_ELLIPTIC_CURVE=y
CONFIG_MBEDTLS_KEY_EXCHANGE_ECDHE_RSA=y
CONFIG_MBEDTLS_KEY_EXCHANGE_ECDHE_ECDSA=y
CONFIG_MBEDTLS_KEY_EXCHANGE_ECDH_ECDSA=y
CONFIG_MBEDTLS_KEY_EXCHANGE_ECDH_RSA=y
CONFIG_MBEDTLS_SSL_RENEGOTIATION=y
CONFIG_MBEDTLS_SSL_PROTO_SSL3=y
CONFIG_MBEDTLS_SSL_PROTO_TLS1=y
CONFIG_MBEDTLS_SSL_PROTO_TLS1_1=y
CONFIG_MBEDTLS_SSL_PROTO_TLS1_2=y
CONFIG_MBEDTLS_SSL_PROTO_DTLS=
CONFIG_MBEDTLS_SSL_ALPN=y
CONFIG_MBEDTLS_SSL_SESSION_TICKETS=y

#
# Symmetric Ciphers
#
CONFIG_MBEDTLS_AES_C=y
CONFIG_MBEDTLS_CAMELLIA_C=
CONFIG_MBEDTLS_DES_C=
CONFIG_MBEDTLS_RC4_DISABLED=y
CONFIG_MBEDTLS_RC4_ENABLED_NO_DEFAULT=
CONFIG_MBEDTLS_RC4_ENABLED=
CONFIG_MBEDTLS_BLOWFISH_C=
CONFIG_MBEDTLS_XTEA_C=
CONFIG_MBEDTLS_CCM_C=y
CONFIG_MBEDTLS_GCM_C=y
CONFIG_MBEDTLS_RIPEMD160_C=

#
# Certificates
#
CONFIG_MBEDTLS_PEM_PARSE_C=y
CONFIG_MBEDTLS_PEM_WRITE_C=y
CONFIG_MBEDTLS_X509_CRL_PARSE_C=y
CONFIG_MBEDTLS_X509_CSR_PARSE_C=y
CONFIG_MBEDTLS_ECP_C=y
CONFIG_MBEDTLS_ECDH_C=y
CONFIG_MBEDTLS_ECDSA_C=y
CONFIG_MBEDTLS_ECP_DP_SECP192R1_ENABLED=y
CONFIG_MBEDTLS_ECP_DP_SECP224R1_ENABLED=y
CONFIG_MBEDTLS_ECP_DP_SECP256R1_ENABLED=y
CONFIG_MBEDTLS_ECP_DP_SECP384R1_ENABLED=y
CONFIG_MBEDTLS_ECP_DP_SECP521R1_ENABLED=y
CONFIG_MBEDTLS_ECP_DP_SECP192K1_ENABLED=y
CONFIG_MBEDTLS_ECP_DP_SECP224K1_ENABLED=y
CONFIG_MBEDTLS_ECP_DP_SECP256K1_ENABLED=y
CONFIG_MBEDTLS_ECP_DP_BP256R1_ENABLED=y
CONFIG_MBEDTLS_ECP_DP_BP384R1_ENABLED=y
CONFIG_MBEDTLS_ECP_DP_BP512R1_ENABLED=y
CONFIG_MBEDTLS_ECP_DP_CURVE25519_ENABLED=y
CONFIG_MBEDTLS_ECP_NIST_OPTIM=y

#
# mDNS
#
CONFIG_MDNS_MAX_SERVICES=10

#
# ESP-MQTT Configurations
#
CONFIG_MQTT_PROTOCOL_311=y
CONFIG_MQTT_TRANSPORT_SSL=y
CONFIG_MQTT_TRANSPORT_WEBSOCKET=y
CONFIG_MQTT_TRANSPORT_WEBSOCKET_SECURE=y
CONFIG_MQTT_USE_CUSTOM_CONFIG=
CONFIG_MQTT_TASK_CORE_SELECTION_ENABLED=
CONFIG_MQTT_CUSTOM_OUTBOX=

#
# Simple REST Interface
#
CONFIG_NANO_REST_DOMAIN="yapraiwallet.space"
CONFIG_NANO_REST_PATH="/api"
CONFIG_NANO_REST_PORT=5523
CONFIG_NANO_REST_RECEIVE_TIMEOUT=15
CONFIG_NANO_REST_RECEIVE_BLOCK_SIZE=512

#
# NVS
#

#
# OpenSSL
#
CONFIG_OPENSSL_DEBUG=
CONFIG_OPENSSL_ASSERT_DO_NOTHING=y
CONFIG_OPENSSL_ASSERT_EXIT=

#
# PThreads
#
CONFIG_ESP32_PTHREAD_TASK_PRIO_DEFAULT=5
CONFIG_ESP32_PTHREAD_TASK_STACK_SIZE_DEFAULT=3072
CONFIG_PTHREAD_STACK_MIN=768
CONFIG_ESP32_DEFAULT_PTHREAD_CORE_NO_AFFINITY=y
CONFIG_ESP32_DEFAULT_PTHREAD_CORE_0=
CONFIG_ESP32_DEFAULT_PTHREAD_CORE_1=
CONFIG_ESP32_PTHREAD_TASK_CORE_DEFAULT=-1
CONFIG_ESP32_PTHREAD_TASK_NAME_DEFAULT="pthread"

#
# SPI Flash driver
#
CONFIG_SPI_FLASH_VERIFY_WRITE=
CONFIG_SPI_FLASH_ENABLE_COUNTERS=
CONFIG_SPI_FLASH_ROM_DRIVER_PATCH=y
CONFIG_SPI_FLASH_WRITING_DANGEROUS_REGIONS_ABORTS=y
CONFIG_SPI_FLASH_WRITING_DANGEROUS_REGIONS_FAILS=
CONFIG_SPI_FLASH_WRITING_DANGEROUS_REGIONS_ALLOWED=

#
# SPIFFS Configuration
#
CONFIG_SPIFFS_MAX_PARTITIONS=3

#
# SPIFFS Cache Configuration
#
CONFIG_SPIFFS_CACHE=y
CONFIG_SPIFFS_CACHE_WR=y
CONFIG_SPIFFS_CACHE_STATS=
CONFIG_SPIFFS_PAGE_CHECK=y
CONFIG_SPIFFS_GC_MAX_RUNS=10
CONFIG_SPIFFS_GC_STATS=
CONFIG_SPIFFS_PAGE_SIZE=256
CONFIG_SPIFFS_OBJ_NAME_LEN=32
CONFIG_SPIFFS_USE_MAGIC=y
CONFIG_SPIFFS_USE_MAGIC_LENGTH=y
CONFIG_SPIFFS_META_LENGTH=4
CONFIG_SPIFFS_USE_MTIME=y

#
# Debug Configuration
#
CONFIG_SPIFFS_DBG=
CONFIG_SPIFFS_API_DBG=
CONFIG_SPIFFS_GC_DBG=
CONFIG_SPIFFS_CACHE_DBG=
CONFIG_SPIFFS_CHECK_DBG=
CONFIG_SPIFFS_TEST_VISUALISATION=

#
# TCP/IP Adapter
#
CONFIG_IP_LOST_TIMER_INTERVAL=120
CONFIG_TCPIP_LWIP=y

#
# Unity unit testing library
#
CONFIG_UNITY_ENABLE_FLOAT=y
CONFIG_UNITY_ENABLE_DOUBLE=y
CONFIG_UNITY_ENABLE_COLOR=y
CONFIG_UNITY_ENABLE_IDF_TEST_RUNNER=y
CONFIG_UNITY_ENABLE_FIXTURE=

#
# Virtual file system
#
CONFIG_SUPPRESS_SELECT_DEBUG_OUTPUT=y
CONFIG_SUPPORT_TERMIOS=y

#
# Wear Levelling
#
CONFIG_WL_SECTOR_SIZE_512=
CONFIG_WL_SECTOR_SIZE_4096=y
CONFIG_WL_SECTOR_SIZE=4096
```
