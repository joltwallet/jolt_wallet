## sdkconfigs/sdkconfig.defaults.dstike
```kconfig
# For the DSTIKE esp32 watch

# Serial Connection
# For some reason (possibly my cable), DSTIKE can't handle 230400
CONFIG_MONITOR_BAUD_115200B=y
CONFIG_ESP_CONSOLE_UART_BAUDRATE=115200

#
# ESP32-specific
#
# DSTIKE can only handle up to 160MHZ
CONFIG_ESP32_DEFAULT_CPU_FREQ_160=y
CONFIG_ESP32_DEFAULT_CPU_FREQ_MHZ=160

#
# Easy_Input Config
#
CONFIG_EASY_INPUT_PUSH_BUTTON_ENABLE=y
CONFIG_EASY_INPUT_TOUCH_ENABLE=n
CONFIG_EASY_INPUT_PUSH_BUTTON_UP_PIN=5
CONFIG_EASY_INPUT_PUSH_BUTTON_DOWN_PIN=19
CONFIG_EASY_INPUT_PUSH_BUTTON_ENTER_PIN=22
CONFIG_EASY_INPUT_PUSH_BUTTON_BACK_PIN=23


#
# Jolt Config
#
CONFIG_JOLT_I2C_PIN_SDA=17
CONFIG_JOLT_I2C_PIN_SCL=16
CONFIG_JOLT_DISPLAY_PIN_RST=23
CONFIG_JOLT_DISPLAY_FLIP=n

CONFIG_JOLT_TOUCH_LED_PIN=27

CONFIG_JOLT_STORE_INTERNAL=y

CONFIG_JOLT_EXT_STORAGE_DAT0_PIN=2
CONFIG_JOLT_EXT_STORAGE_DAT1_PIN=4
CONFIG_JOLT_EXT_STORAGE_DAT2_PIN=12
CONFIG_JOLT_EXT_STORAGE_DAT2_PIN=13
CONFIG_JOLT_EXT_STORAGE_CMD_PIN=15
CONFIG_JOLT_EXT_STORAGE_CLK_PIN=14
```

## sdkconfigs/sdkconfig.defaults.wrover
```kconfig
# For the ESP-WROVER-KIT


#
# Easy_Input Config
#
CONFIG_EASY_INPUT_PUSH_BUTTON_ENABLE=y
CONFIG_EASY_INPUT_TOUCH_ENABLE=n
CONFIG_EASY_INPUT_PUSH_BUTTON_UP_PIN=13
CONFIG_EASY_INPUT_PUSH_BUTTON_DOWN_PIN=25
CONFIG_EASY_INPUT_PUSH_BUTTON_ENTER_PIN=26
CONFIG_EASY_INPUT_PUSH_BUTTON_BACK_PIN=27


#
# Jolt Config
#
CONFIG_JOLT_I2C_PIN_SDA=14
CONFIG_JOLT_I2C_PIN_SCL=12
CONFIG_JOLT_DISPLAY_PIN_RST=-1
CONFIG_JOLT_DISPLAY_FLIP=y

CONFIG_JOLT_TOUCH_LED_PIN=4

CONFIG_JOLT_STORE_INTERNAL=y

CONFIG_JOLT_EXT_STORAGE_DAT0_PIN=2
CONFIG_JOLT_EXT_STORAGE_DAT1_PIN=4
CONFIG_JOLT_EXT_STORAGE_DAT2_PIN=12
CONFIG_JOLT_EXT_STORAGE_DAT2_PIN=13
CONFIG_JOLT_EXT_STORAGE_CMD_PIN=15
CONFIG_JOLT_EXT_STORAGE_CLK_PIN=14
```
